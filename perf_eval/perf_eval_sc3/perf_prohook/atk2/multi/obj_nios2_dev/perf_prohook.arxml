AUTOSAR XML (schema 4-0-3)
package /Ecuc
  module config Os: ecuc-def-edition=4.2.0, implementation-config-variant=VARIANT-PRE-COMPILE
    3 x OsInclude:
      OsInclude1: OsIncludeFileName=perf_prohook_t.h
      OsInclude2: OsIncludeFileName=test_target_lib.h
      OsInclude3: OsIncludeFileName=perf_prohook_nt.h
    OsOS: OsNumberOfCores=2, OsStackMonitoring=false, OsUseGetServiceId=true, OsUseParameterAccess=true, OsScalabilityClass=SC3, OsStatus=EXTENDED
      OsHooks: OsErrorHook=true, OsPostTaskHook=false, OsPreTaskHook=false, OsProtectionHook=true, OsShutdownHook=false, OsStartupHook=false
    MainApp (OsAppMode)
    T_OSAP1_ProHook_A_Isr2 (OsIsr):
      OsIsrCategory = CATEGORY_2
      OsIsrInterruptNumber = INTNO_PROHOOK_A
      OsIsrInterruptSource = ENABLE
      OsIsrInterruptPriority = INTPRI_TIMER_NUM
      OsIsrStackSize = ISR_STACK_SIZE
    26 x OsTask, all with OsTaskActivation=1, OsTaskStackSize=TASK_STACK_SIZE, OsTaskSchedule=FULL:
      MainTask: OsTaskPriority=1
        OsTaskAutostart: OsTaskAppModeRef=MainApp
      NT_OSAP1_ProHook_A_Task1: OsTaskPriority=2
      NT_OSAP1_ProHook_A_Task2: OsTaskPriority=3
      NT_OSAP1_ProHook_B_Task1: OsTaskPriority=2, OsTaskAccessingApplication=NT_OSAP2_PROHOOK_B
      NT_OSAP2_ProHook_B_Task2: OsTaskPriority=3
      NT_OSAP2_ProHook_A_Task3: OsTaskPriority=4, OsTaskAccessingApplication=NT_OSAP1_PROHOOK_A
      NT_OSAP2_ProHook_A_ReTask4: OsTaskPriority=5
      NT_OSAP3_ProHook_B_Task3: OsTaskPriority=2, OsTaskAccessingApplication=NT_OSAP4_PROHOOK_B
      NT_OSAP4_ProHook_B_Task4: OsTaskPriority=3
      NT_OSAP5_ProHook_B_Task5: OsTaskPriority=2, OsTaskAccessingApplication=NT_OSAP6_PROHOOK_B
      NT_OSAP6_ProHook_B_Task6: OsTaskPriority=3
      NT_OSAP7_ProHook_B_Task7: OsTaskPriority=2, OsTaskAccessingApplication=NT_OSAP8_PROHOOK_B
      NT_OSAP8_ProHook_B_Task8: OsTaskPriority=3
      NT_OSAP9_ProHook_B_Task9: OsTaskPriority=2, OsTaskAccessingApplication=NT_OSAP10_PROHOOK_B
      NT_OSAP10_ProHook_B_Task10: OsTaskPriority=3
      NT_OSAP11_ProHook_B_Task11: OsTaskPriority=2, OsTaskAccessingApplication=NT_OSAP12_PROHOOK_B
      NT_OSAP12_ProHook_B_Task12: OsTaskPriority=3
      NT_OSAP13_ProHook_B_Task13: OsTaskPriority=2, OsTaskAccessingApplication=NT_OSAP14_PROHOOK_B
      NT_OSAP14_ProHook_B_Task14: OsTaskPriority=3
      NT_OSAP15_ProHook_B_Task15: OsTaskPriority=2, OsTaskAccessingApplication=NT_OSAP16_PROHOOK_B
      NT_OSAP16_ProHook_B_Task16: OsTaskPriority=3
      NT_OSAP17_ProHook_B_Task17: OsTaskPriority=2, OsTaskAccessingApplication=NT_OSAP18_PROHOOK_B
      NT_OSAP18_ProHook_B_Task18: OsTaskPriority=3
      NT_OSAP19_ProHook_B_Task19: OsTaskPriority=2, OsTaskAccessingApplication=NT_OSAP20_PROHOOK_B
      NT_OSAP20_ProHook_B_Task20: OsTaskPriority=3
      S_IdleTask: OsTaskPriority=1
    25 x OsApplication:
      T_OSAP_MAIN: OsTrusted=true, OsApplicationCoreAssignment=OS_CORE_ID_MASTER, OsAppTaskRef=MainTask
        OsApplicationHooks: OsAppErrorHook=false, OsAppShutdownHook=false, OsAppStartupHook=false
        PROHOOK_ISR2_TFN (OsApplicationTrustedFunction): OsTrustedFunctionName=TRUSTED_prohook_isr2_tfn
      T_OSAP1: OsTrusted=true, OsApplicationCoreAssignment=OS_CORE_ID_MASTER, OsAppIsrRef=T_OSAP1_ProHook_A_Isr2
        OsApplicationHooks: OsAppErrorHook=false, OsAppShutdownHook=false, OsAppStartupHook=false
      T_OSAP1_S: OsTrusted=true, OsApplicationCoreAssignment=OS_CORE_ID_SLAVE, OsAppTaskRef=S_IdleTask
        OsApplicationHooks: OsAppErrorHook=false, OsAppShutdownHook=false, OsAppStartupHook=false
      NT_OSAP1_PROHOOK_A: OsTrusted=false, OsApplicationCoreAssignment=OS_CORE_ID_MASTER, OsAppTaskRef=NT_OSAP1_ProHook_A_Task1, OsAppTaskRef=NT_OSAP1_ProHook_A_Task2
        OsApplicationHooks: OsAppErrorHook=false, OsAppShutdownHook=false, OsAppStartupHook=false
      NT_OSAP2_PROHOOK_A: OsTrusted=false, OsApplicationCoreAssignment=OS_CORE_ID_MASTER, OsAppTaskRef=NT_OSAP2_ProHook_A_Task3, OsAppTaskRef=NT_OSAP2_ProHook_A_ReTask4, OsRestartTask=NT_OSAP2_ProHook_A_ReTask4
        OsApplicationHooks: OsAppErrorHook=false, OsAppShutdownHook=false, OsAppStartupHook=false
      NT_OSAP1_PROHOOK_B: OsTrusted=false, OsApplicationCoreAssignment=OS_CORE_ID_MASTER, OsAppTaskRef=NT_OSAP1_ProHook_B_Task1
        OsApplicationHooks: OsAppErrorHook=false, OsAppShutdownHook=false, OsAppStartupHook=false
      NT_OSAP2_PROHOOK_B: OsTrusted=false, OsApplicationCoreAssignment=OS_CORE_ID_MASTER, OsAppTaskRef=NT_OSAP2_ProHook_B_Task2
        OsApplicationHooks: OsAppErrorHook=false, OsAppShutdownHook=false, OsAppStartupHook=false
      NT_OSAP3_PROHOOK_B: OsTrusted=false, OsApplicationCoreAssignment=OS_CORE_ID_MASTER, OsAppTaskRef=NT_OSAP3_ProHook_B_Task3
        OsApplicationHooks: OsAppErrorHook=false, OsAppShutdownHook=false, OsAppStartupHook=false
      NT_OSAP4_PROHOOK_B: OsTrusted=false, OsApplicationCoreAssignment=OS_CORE_ID_MASTER, OsAppTaskRef=NT_OSAP4_ProHook_B_Task4
        OsApplicationHooks: OsAppErrorHook=false, OsAppShutdownHook=false, OsAppStartupHook=false
      NT_OSAP5_PROHOOK_B: OsTrusted=false, OsApplicationCoreAssignment=OS_CORE_ID_MASTER, OsAppTaskRef=NT_OSAP5_ProHook_B_Task5
        OsApplicationHooks: OsAppErrorHook=false, OsAppShutdownHook=false, OsAppStartupHook=false
      NT_OSAP6_PROHOOK_B: OsTrusted=false, OsApplicationCoreAssignment=OS_CORE_ID_MASTER, OsAppTaskRef=NT_OSAP6_ProHook_B_Task6
        OsApplicationHooks: OsAppErrorHook=false, OsAppShutdownHook=false, OsAppStartupHook=false
      NT_OSAP7_PROHOOK_B: OsTrusted=false, OsApplicationCoreAssignment=OS_CORE_ID_MASTER, OsAppTaskRef=NT_OSAP7_ProHook_B_Task7
        OsApplicationHooks: OsAppErrorHook=false, OsAppShutdownHook=false, OsAppStartupHook=false
      NT_OSAP8_PROHOOK_B: OsTrusted=false, OsApplicationCoreAssignment=OS_CORE_ID_MASTER, OsAppTaskRef=NT_OSAP8_ProHook_B_Task8
        OsApplicationHooks: OsAppErrorHook=false, OsAppShutdownHook=false, OsAppStartupHook=false
      NT_OSAP9_PROHOOK_B: OsTrusted=false, OsApplicationCoreAssignment=OS_CORE_ID_MASTER, OsAppTaskRef=NT_OSAP9_ProHook_B_Task9
        OsApplicationHooks: OsAppErrorHook=false, OsAppShutdownHook=false, OsAppStartupHook=false
      NT_OSAP10_PROHOOK_B: OsTrusted=false, OsApplicationCoreAssignment=OS_CORE_ID_MASTER, OsAppTaskRef=NT_OSAP10_ProHook_B_Task10
        OsApplicationHooks: OsAppErrorHook=false, OsAppShutdownHook=false, OsAppStartupHook=false
      NT_OSAP11_PROHOOK_B: OsTrusted=false, OsApplicationCoreAssignment=OS_CORE_ID_MASTER, OsAppTaskRef=NT_OSAP11_ProHook_B_Task11
        OsApplicationHooks: OsAppErrorHook=false, OsAppShutdownHook=false, OsAppStartupHook=false
      NT_OSAP12_PROHOOK_B: OsTrusted=false, OsApplicationCoreAssignment=OS_CORE_ID_MASTER, OsAppTaskRef=NT_OSAP12_ProHook_B_Task12
        OsApplicationHooks: OsAppErrorHook=false, OsAppShutdownHook=false, OsAppStartupHook=false
      NT_OSAP13_PROHOOK_B: OsTrusted=false, OsApplicationCoreAssignment=OS_CORE_ID_MASTER, OsAppTaskRef=NT_OSAP13_ProHook_B_Task13
        OsApplicationHooks: OsAppErrorHook=false, OsAppShutdownHook=false, OsAppStartupHook=false
      NT_OSAP14_PROHOOK_B: OsTrusted=false, OsApplicationCoreAssignment=OS_CORE_ID_MASTER, OsAppTaskRef=NT_OSAP14_ProHook_B_Task14
        OsApplicationHooks: OsAppErrorHook=false, OsAppShutdownHook=false, OsAppStartupHook=false
      NT_OSAP15_PROHOOK_B: OsTrusted=false, OsApplicationCoreAssignment=OS_CORE_ID_MASTER, OsAppTaskRef=NT_OSAP15_ProHook_B_Task15
        OsApplicationHooks: OsAppErrorHook=false, OsAppShutdownHook=false, OsAppStartupHook=false
      NT_OSAP16_PROHOOK_B: OsTrusted=false, OsApplicationCoreAssignment=OS_CORE_ID_MASTER, OsAppTaskRef=NT_OSAP16_ProHook_B_Task16
        OsApplicationHooks: OsAppErrorHook=false, OsAppShutdownHook=false, OsAppStartupHook=false
      NT_OSAP17_PROHOOK_B: OsTrusted=false, OsApplicationCoreAssignment=OS_CORE_ID_MASTER, OsAppTaskRef=NT_OSAP17_ProHook_B_Task17
        OsApplicationHooks: OsAppErrorHook=false, OsAppShutdownHook=false, OsAppStartupHook=false
      NT_OSAP18_PROHOOK_B: OsTrusted=false, OsApplicationCoreAssignment=OS_CORE_ID_MASTER, OsAppTaskRef=NT_OSAP18_ProHook_B_Task18
        OsApplicationHooks: OsAppErrorHook=false, OsAppShutdownHook=false, OsAppStartupHook=false
      NT_OSAP19_PROHOOK_B: OsTrusted=false, OsApplicationCoreAssignment=OS_CORE_ID_MASTER, OsAppTaskRef=NT_OSAP19_ProHook_B_Task19
        OsApplicationHooks: OsAppErrorHook=false, OsAppShutdownHook=false, OsAppStartupHook=false
      NT_OSAP20_PROHOOK_B: OsTrusted=false, OsApplicationCoreAssignment=OS_CORE_ID_MASTER, OsAppTaskRef=NT_OSAP20_ProHook_B_Task20
        OsApplicationHooks: OsAppErrorHook=false, OsAppShutdownHook=false, OsAppStartupHook=false
