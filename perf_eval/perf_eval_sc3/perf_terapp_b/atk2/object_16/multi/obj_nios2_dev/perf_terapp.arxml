AUTOSAR XML (schema 4-0-3)
package /Ecuc
  module config Os: ecuc-def-edition=4.2.0, implementation-config-variant=VARIANT-PRE-COMPILE
    OsInclude1 (OsInclude): OsIncludeFileName=perf_terapp_t.h
    OsInclude2 (OsInclude): OsIncludeFileName=test_target_lib.h
    OsOS: OsNumberOfCores=2, OsStackMonitoring=false, OsUseGetServiceId=true, OsUseParameterAccess=true, OsScalabilityClass=SC3, OsStatus=EXTENDED
      OsHooks: OsErrorHook=true, OsPostTaskHook=false, OsPreTaskHook=false, OsProtectionHook=true, OsShutdownHook=false, OsStartupHook=false
    MainApp (OsAppMode)
    172 x OsTask, all with OsTaskActivation=1, OsTaskStackSize=TASK_STACK_SIZE, OsTaskSchedule=FULL:
      MainTask: OsTaskPriority=1
        OsTaskAutostart: OsTaskAppModeRef=MainApp
      T_OSAP{1..10}_TerApp_B_Task2: OsTaskPriority=3
      NT_OSAP1_TerApp_B_Task1: OsTaskPriority=2
      NT_OSAP1_TerApp_B_Task{3..17}: OsTaskPriority=2
      NT_OSAP2_TerApp_B_Task1: OsTaskPriority=2
      NT_OSAP2_TerApp_B_Task{3..17}: OsTaskPriority=2
      NT_OSAP3_TerApp_B_Task1: OsTaskPriority=2
      NT_OSAP3_TerApp_B_Task{3..17}: OsTaskPriority=2
      NT_OSAP4_TerApp_B_Task1: OsTaskPriority=2
      NT_OSAP4_TerApp_B_Task{3..17}: OsTaskPriority=2
      NT_OSAP5_TerApp_B_Task1: OsTaskPriority=2
      NT_OSAP5_TerApp_B_Task{3..17}: OsTaskPriority=2
      NT_OSAP6_TerApp_B_Task1: OsTaskPriority=2
      NT_OSAP6_TerApp_B_Task{3..17}: OsTaskPriority=2
      NT_OSAP7_TerApp_B_Task1: OsTaskPriority=2
      NT_OSAP7_TerApp_B_Task{3..17}: OsTaskPriority=2
      NT_OSAP8_TerApp_B_Task1: OsTaskPriority=2
      NT_OSAP8_TerApp_B_Task{3..17}: OsTaskPriority=2
      NT_OSAP9_TerApp_B_Task1: OsTaskPriority=2
      NT_OSAP9_TerApp_B_Task{3..17}: OsTaskPriority=2
      NT_OSAP10_TerApp_B_Task1: OsTaskPriority=2
      NT_OSAP10_TerApp_B_Task{3..17}: OsTaskPriority=2
      S_IdleTask: OsTaskPriority=1
    22 x OsApplication:
      T_OSAP_MAIN: OsTrusted=true, OsApplicationCoreAssignment=OS_CORE_ID_MASTER, OsAppTaskRef=MainTask
        OsApplicationHooks: OsAppErrorHook=false, OsAppShutdownHook=false, OsAppStartupHook=false
      T_OSAP1: OsTrusted=true, OsApplicationCoreAssignment=OS_CORE_ID_MASTER, OsAppTaskRef=T_OSAP1_TerApp_B_Task2
        OsApplicationHooks: OsAppErrorHook=false, OsAppShutdownHook=false, OsAppStartupHook=false
      T_OSAP1_S: OsTrusted=true, OsApplicationCoreAssignment=OS_CORE_ID_SLAVE, OsAppTaskRef=S_IdleTask
        OsApplicationHooks: OsAppErrorHook=false, OsAppShutdownHook=false, OsAppStartupHook=false
      T_OSAP2: OsTrusted=true, OsApplicationCoreAssignment=OS_CORE_ID_MASTER, OsAppTaskRef=T_OSAP2_TerApp_B_Task2
        OsApplicationHooks: OsAppErrorHook=false, OsAppShutdownHook=false, OsAppStartupHook=false
      T_OSAP3: OsTrusted=true, OsApplicationCoreAssignment=OS_CORE_ID_MASTER, OsAppTaskRef=T_OSAP3_TerApp_B_Task2
        OsApplicationHooks: OsAppErrorHook=false, OsAppShutdownHook=false, OsAppStartupHook=false
      T_OSAP4: OsTrusted=true, OsApplicationCoreAssignment=OS_CORE_ID_MASTER, OsAppTaskRef=T_OSAP4_TerApp_B_Task2
        OsApplicationHooks: OsAppErrorHook=false, OsAppShutdownHook=false, OsAppStartupHook=false
      T_OSAP5: OsTrusted=true, OsApplicationCoreAssignment=OS_CORE_ID_MASTER, OsAppTaskRef=T_OSAP5_TerApp_B_Task2
        OsApplicationHooks: OsAppErrorHook=false, OsAppShutdownHook=false, OsAppStartupHook=false
      T_OSAP6: OsTrusted=true, OsApplicationCoreAssignment=OS_CORE_ID_MASTER, OsAppTaskRef=T_OSAP6_TerApp_B_Task2
        OsApplicationHooks: OsAppErrorHook=false, OsAppShutdownHook=false, OsAppStartupHook=false
      T_OSAP7: OsTrusted=true, OsApplicationCoreAssignment=OS_CORE_ID_MASTER, OsAppTaskRef=T_OSAP7_TerApp_B_Task2
        OsApplicationHooks: OsAppErrorHook=false, OsAppShutdownHook=false, OsAppStartupHook=false
      T_OSAP8: OsTrusted=true, OsApplicationCoreAssignment=OS_CORE_ID_MASTER, OsAppTaskRef=T_OSAP8_TerApp_B_Task2
        OsApplicationHooks: OsAppErrorHook=false, OsAppShutdownHook=false, OsAppStartupHook=false
      T_OSAP9: OsTrusted=true, OsApplicationCoreAssignment=OS_CORE_ID_MASTER, OsAppTaskRef=T_OSAP9_TerApp_B_Task2
        OsApplicationHooks: OsAppErrorHook=false, OsAppShutdownHook=false, OsAppStartupHook=false
      T_OSAP10: OsTrusted=true, OsApplicationCoreAssignment=OS_CORE_ID_MASTER, OsAppTaskRef=T_OSAP10_TerApp_B_Task2
        OsApplicationHooks: OsAppErrorHook=false, OsAppShutdownHook=false, OsAppStartupHook=false
      NT_OSAP1: OsTrusted=false, OsApplicationCoreAssignment=OS_CORE_ID_MASTER, OsAppTaskRef=NT_OSAP1_TerApp_B_Task1, OsAppTaskRef=NT_OSAP1_TerApp_B_Task3, OsAppTaskRef=NT_OSAP1_TerApp_B_Task4, OsAppTaskRef=NT_OSAP1_TerApp_B_Task5, OsAppTaskRef=NT_OSAP1_TerApp_B_Task6, OsAppTaskRef=NT_OSAP1_TerApp_B_Task7, OsAppTaskRef=NT_OSAP1_TerApp_B_Task8, OsAppTaskRef=NT_OSAP1_TerApp_B_Task9, OsAppTaskRef=NT_OSAP1_TerApp_B_Task10, OsAppTaskRef=NT_OSAP1_TerApp_B_Task11, OsAppTaskRef=NT_OSAP1_TerApp_B_Task12, OsAppTaskRef=NT_OSAP1_TerApp_B_Task13, OsAppTaskRef=NT_OSAP1_TerApp_B_Task14, OsAppTaskRef=NT_OSAP1_TerApp_B_Task15, OsAppTaskRef=NT_OSAP1_TerApp_B_Task16, OsAppTaskRef=NT_OSAP1_TerApp_B_Task17
        OsApplicationHooks: OsAppErrorHook=false, OsAppShutdownHook=false, OsAppStartupHook=false
      NT_OSAP2: OsTrusted=false, OsApplicationCoreAssignment=OS_CORE_ID_MASTER, OsAppTaskRef=NT_OSAP2_TerApp_B_Task1, OsAppTaskRef=NT_OSAP2_TerApp_B_Task3, OsAppTaskRef=NT_OSAP2_TerApp_B_Task4, OsAppTaskRef=NT_OSAP2_TerApp_B_Task5, OsAppTaskRef=NT_OSAP2_TerApp_B_Task6, OsAppTaskRef=NT_OSAP2_TerApp_B_Task7, OsAppTaskRef=NT_OSAP2_TerApp_B_Task8, OsAppTaskRef=NT_OSAP2_TerApp_B_Task9, OsAppTaskRef=NT_OSAP2_TerApp_B_Task10, OsAppTaskRef=NT_OSAP2_TerApp_B_Task11, OsAppTaskRef=NT_OSAP2_TerApp_B_Task12, OsAppTaskRef=NT_OSAP2_TerApp_B_Task13, OsAppTaskRef=NT_OSAP2_TerApp_B_Task14, OsAppTaskRef=NT_OSAP2_TerApp_B_Task15, OsAppTaskRef=NT_OSAP2_TerApp_B_Task16, OsAppTaskRef=NT_OSAP2_TerApp_B_Task17
        OsApplicationHooks: OsAppErrorHook=false, OsAppShutdownHook=false, OsAppStartupHook=false
      NT_OSAP3: OsTrusted=false, OsApplicationCoreAssignment=OS_CORE_ID_MASTER, OsAppTaskRef=NT_OSAP3_TerApp_B_Task1, OsAppTaskRef=NT_OSAP3_TerApp_B_Task3, OsAppTaskRef=NT_OSAP3_TerApp_B_Task4, OsAppTaskRef=NT_OSAP3_TerApp_B_Task5, OsAppTaskRef=NT_OSAP3_TerApp_B_Task6, OsAppTaskRef=NT_OSAP3_TerApp_B_Task7, OsAppTaskRef=NT_OSAP3_TerApp_B_Task8, OsAppTaskRef=NT_OSAP3_TerApp_B_Task9, OsAppTaskRef=NT_OSAP3_TerApp_B_Task10, OsAppTaskRef=NT_OSAP3_TerApp_B_Task11, OsAppTaskRef=NT_OSAP3_TerApp_B_Task12, OsAppTaskRef=NT_OSAP3_TerApp_B_Task13, OsAppTaskRef=NT_OSAP3_TerApp_B_Task14, OsAppTaskRef=NT_OSAP3_TerApp_B_Task15, OsAppTaskRef=NT_OSAP3_TerApp_B_Task16, OsAppTaskRef=NT_OSAP3_TerApp_B_Task17
        OsApplicationHooks: OsAppErrorHook=false, OsAppShutdownHook=false, OsAppStartupHook=false
      NT_OSAP4: OsTrusted=false, OsApplicationCoreAssignment=OS_CORE_ID_MASTER, OsAppTaskRef=NT_OSAP4_TerApp_B_Task1, OsAppTaskRef=NT_OSAP4_TerApp_B_Task3, OsAppTaskRef=NT_OSAP4_TerApp_B_Task4, OsAppTaskRef=NT_OSAP4_TerApp_B_Task5, OsAppTaskRef=NT_OSAP4_TerApp_B_Task6, OsAppTaskRef=NT_OSAP4_TerApp_B_Task7, OsAppTaskRef=NT_OSAP4_TerApp_B_Task8, OsAppTaskRef=NT_OSAP4_TerApp_B_Task9, OsAppTaskRef=NT_OSAP4_TerApp_B_Task10, OsAppTaskRef=NT_OSAP4_TerApp_B_Task11, OsAppTaskRef=NT_OSAP4_TerApp_B_Task12, OsAppTaskRef=NT_OSAP4_TerApp_B_Task13, OsAppTaskRef=NT_OSAP4_TerApp_B_Task14, OsAppTaskRef=NT_OSAP4_TerApp_B_Task15, OsAppTaskRef=NT_OSAP4_TerApp_B_Task16, OsAppTaskRef=NT_OSAP4_TerApp_B_Task17
        OsApplicationHooks: OsAppErrorHook=false, OsAppShutdownHook=false, OsAppStartupHook=false
      NT_OSAP5: OsTrusted=false, OsApplicationCoreAssignment=OS_CORE_ID_MASTER, OsAppTaskRef=NT_OSAP5_TerApp_B_Task1, OsAppTaskRef=NT_OSAP5_TerApp_B_Task3, OsAppTaskRef=NT_OSAP5_TerApp_B_Task4, OsAppTaskRef=NT_OSAP5_TerApp_B_Task5, OsAppTaskRef=NT_OSAP5_TerApp_B_Task6, OsAppTaskRef=NT_OSAP5_TerApp_B_Task7, OsAppTaskRef=NT_OSAP5_TerApp_B_Task8, OsAppTaskRef=NT_OSAP5_TerApp_B_Task9, OsAppTaskRef=NT_OSAP5_TerApp_B_Task10, OsAppTaskRef=NT_OSAP5_TerApp_B_Task11, OsAppTaskRef=NT_OSAP5_TerApp_B_Task12, OsAppTaskRef=NT_OSAP5_TerApp_B_Task13, OsAppTaskRef=NT_OSAP5_TerApp_B_Task14, OsAppTaskRef=NT_OSAP5_TerApp_B_Task15, OsAppTaskRef=NT_OSAP5_TerApp_B_Task16, OsAppTaskRef=NT_OSAP5_TerApp_B_Task17
        OsApplicationHooks: OsAppErrorHook=false, OsAppShutdownHook=false, OsAppStartupHook=false
      NT_OSAP6: OsTrusted=false, OsApplicationCoreAssignment=OS_CORE_ID_MASTER, OsAppTaskRef=NT_OSAP6_TerApp_B_Task1, OsAppTaskRef=NT_OSAP6_TerApp_B_Task3, OsAppTaskRef=NT_OSAP6_TerApp_B_Task4, OsAppTaskRef=NT_OSAP6_TerApp_B_Task5, OsAppTaskRef=NT_OSAP6_TerApp_B_Task6, OsAppTaskRef=NT_OSAP6_TerApp_B_Task7, OsAppTaskRef=NT_OSAP6_TerApp_B_Task8, OsAppTaskRef=NT_OSAP6_TerApp_B_Task9, OsAppTaskRef=NT_OSAP6_TerApp_B_Task10, OsAppTaskRef=NT_OSAP6_TerApp_B_Task11, OsAppTaskRef=NT_OSAP6_TerApp_B_Task12, OsAppTaskRef=NT_OSAP6_TerApp_B_Task13, OsAppTaskRef=NT_OSAP6_TerApp_B_Task14, OsAppTaskRef=NT_OSAP6_TerApp_B_Task15, OsAppTaskRef=NT_OSAP6_TerApp_B_Task16, OsAppTaskRef=NT_OSAP6_TerApp_B_Task17
        OsApplicationHooks: OsAppErrorHook=false, OsAppShutdownHook=false, OsAppStartupHook=false
      NT_OSAP7: OsTrusted=false, OsApplicationCoreAssignment=OS_CORE_ID_MASTER, OsAppTaskRef=NT_OSAP7_TerApp_B_Task1, OsAppTaskRef=NT_OSAP7_TerApp_B_Task3, OsAppTaskRef=NT_OSAP7_TerApp_B_Task4, OsAppTaskRef=NT_OSAP7_TerApp_B_Task5, OsAppTaskRef=NT_OSAP7_TerApp_B_Task6, OsAppTaskRef=NT_OSAP7_TerApp_B_Task7, OsAppTaskRef=NT_OSAP7_TerApp_B_Task8, OsAppTaskRef=NT_OSAP7_TerApp_B_Task9, OsAppTaskRef=NT_OSAP7_TerApp_B_Task10, OsAppTaskRef=NT_OSAP7_TerApp_B_Task11, OsAppTaskRef=NT_OSAP7_TerApp_B_Task12, OsAppTaskRef=NT_OSAP7_TerApp_B_Task13, OsAppTaskRef=NT_OSAP7_TerApp_B_Task14, OsAppTaskRef=NT_OSAP7_TerApp_B_Task15, OsAppTaskRef=NT_OSAP7_TerApp_B_Task16, OsAppTaskRef=NT_OSAP7_TerApp_B_Task17
        OsApplicationHooks: OsAppErrorHook=false, OsAppShutdownHook=false, OsAppStartupHook=false
      NT_OSAP8: OsTrusted=false, OsApplicationCoreAssignment=OS_CORE_ID_MASTER, OsAppTaskRef=NT_OSAP8_TerApp_B_Task1, OsAppTaskRef=NT_OSAP8_TerApp_B_Task3, OsAppTaskRef=NT_OSAP8_TerApp_B_Task4, OsAppTaskRef=NT_OSAP8_TerApp_B_Task5, OsAppTaskRef=NT_OSAP8_TerApp_B_Task6, OsAppTaskRef=NT_OSAP8_TerApp_B_Task7, OsAppTaskRef=NT_OSAP8_TerApp_B_Task8, OsAppTaskRef=NT_OSAP8_TerApp_B_Task9, OsAppTaskRef=NT_OSAP8_TerApp_B_Task10, OsAppTaskRef=NT_OSAP8_TerApp_B_Task11, OsAppTaskRef=NT_OSAP8_TerApp_B_Task12, OsAppTaskRef=NT_OSAP8_TerApp_B_Task13, OsAppTaskRef=NT_OSAP8_TerApp_B_Task14, OsAppTaskRef=NT_OSAP8_TerApp_B_Task15, OsAppTaskRef=NT_OSAP8_TerApp_B_Task16, OsAppTaskRef=NT_OSAP8_TerApp_B_Task17
        OsApplicationHooks: OsAppErrorHook=false, OsAppShutdownHook=false, OsAppStartupHook=false
      NT_OSAP9: OsTrusted=false, OsApplicationCoreAssignment=OS_CORE_ID_MASTER, OsAppTaskRef=NT_OSAP9_TerApp_B_Task1, OsAppTaskRef=NT_OSAP9_TerApp_B_Task3, OsAppTaskRef=NT_OSAP9_TerApp_B_Task4, OsAppTaskRef=NT_OSAP9_TerApp_B_Task5, OsAppTaskRef=NT_OSAP9_TerApp_B_Task6, OsAppTaskRef=NT_OSAP9_TerApp_B_Task7, OsAppTaskRef=NT_OSAP9_TerApp_B_Task8, OsAppTaskRef=NT_OSAP9_TerApp_B_Task9, OsAppTaskRef=NT_OSAP9_TerApp_B_Task10, OsAppTaskRef=NT_OSAP9_TerApp_B_Task11, OsAppTaskRef=NT_OSAP9_TerApp_B_Task12, OsAppTaskRef=NT_OSAP9_TerApp_B_Task13, OsAppTaskRef=NT_OSAP9_TerApp_B_Task14, OsAppTaskRef=NT_OSAP9_TerApp_B_Task15, OsAppTaskRef=NT_OSAP9_TerApp_B_Task16, OsAppTaskRef=NT_OSAP9_TerApp_B_Task17
        OsApplicationHooks: OsAppErrorHook=false, OsAppShutdownHook=false, OsAppStartupHook=false
      NT_OSAP10: OsTrusted=false, OsApplicationCoreAssignment=OS_CORE_ID_MASTER, OsAppTaskRef=NT_OSAP10_TerApp_B_Task1, OsAppTaskRef=NT_OSAP10_TerApp_B_Task3, OsAppTaskRef=NT_OSAP10_TerApp_B_Task4, OsAppTaskRef=NT_OSAP10_TerApp_B_Task5, OsAppTaskRef=NT_OSAP10_TerApp_B_Task6, OsAppTaskRef=NT_OSAP10_TerApp_B_Task7, OsAppTaskRef=NT_OSAP10_TerApp_B_Task8, OsAppTaskRef=NT_OSAP10_TerApp_B_Task9, OsAppTaskRef=NT_OSAP10_TerApp_B_Task10, OsAppTaskRef=NT_OSAP10_TerApp_B_Task11, OsAppTaskRef=NT_OSAP10_TerApp_B_Task12, OsAppTaskRef=NT_OSAP10_TerApp_B_Task13, OsAppTaskRef=NT_OSAP10_TerApp_B_Task14, OsAppTaskRef=NT_OSAP10_TerApp_B_Task15, OsAppTaskRef=NT_OSAP10_TerApp_B_Task16, OsAppTaskRef=NT_OSAP10_TerApp_B_Task17
        OsApplicationHooks: OsAppErrorHook=false, OsAppShutdownHook=false, OsAppStartupHook=false
