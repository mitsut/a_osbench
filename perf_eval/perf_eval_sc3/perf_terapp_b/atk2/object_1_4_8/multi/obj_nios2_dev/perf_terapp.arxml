AUTOSAR XML (schema 4-0-3)
package /Ecuc
  module config Os: ecuc-def-edition=4.2.0, implementation-config-variant=VARIANT-PRE-COMPILE
    OsInclude1 (OsInclude): OsIncludeFileName=perf_terapp_t.h
    OsInclude2 (OsInclude): OsIncludeFileName=test_target_lib.h
    OsOS: OsNumberOfCores=2, OsStackMonitoring=false, OsUseGetServiceId=true, OsUseParameterAccess=true, OsScalabilityClass=SC3, OsStatus=EXTENDED
      OsHooks: OsErrorHook=true, OsPostTaskHook=false, OsPreTaskHook=false, OsProtectionHook=true, OsShutdownHook=false, OsStartupHook=false
    MainApp (OsAppMode)
    162 x OsTask, all with OsTaskActivation=1, OsTaskStackSize=TASK_STACK_SIZE, OsTaskSchedule=FULL:
      MainTask: OsTaskPriority=1
        OsTaskAutostart: OsTaskAppModeRef=MainApp
      T_OSAP{1..30}_TerApp_B_Task2: OsTaskPriority=3
      NT_OSAP{1..11}_TerApp_B_Task1: OsTaskPriority=2
      NT_OSAP11_TerApp_B_Task{3..5}: OsTaskPriority=2
      NT_OSAP12_TerApp_B_Task1: OsTaskPriority=2
      NT_OSAP12_TerApp_B_Task{3..5}: OsTaskPriority=2
      NT_OSAP13_TerApp_B_Task1: OsTaskPriority=2
      NT_OSAP13_TerApp_B_Task{3..5}: OsTaskPriority=2
      NT_OSAP14_TerApp_B_Task1: OsTaskPriority=2
      NT_OSAP14_TerApp_B_Task{3..5}: OsTaskPriority=2
      NT_OSAP15_TerApp_B_Task1: OsTaskPriority=2
      NT_OSAP15_TerApp_B_Task{3..5}: OsTaskPriority=2
      NT_OSAP16_TerApp_B_Task1: OsTaskPriority=2
      NT_OSAP16_TerApp_B_Task{3..5}: OsTaskPriority=2
      NT_OSAP17_TerApp_B_Task1: OsTaskPriority=2
      NT_OSAP17_TerApp_B_Task{3..5}: OsTaskPriority=2
      NT_OSAP18_TerApp_B_Task1: OsTaskPriority=2
      NT_OSAP18_TerApp_B_Task{3..5}: OsTaskPriority=2
      NT_OSAP19_TerApp_B_Task1: OsTaskPriority=2
      NT_OSAP19_TerApp_B_Task{3..5}: OsTaskPriority=2
      NT_OSAP20_TerApp_B_Task1: OsTaskPriority=2
      NT_OSAP20_TerApp_B_Task{3..5}: OsTaskPriority=2
      NT_OSAP21_TerApp_B_Task1: OsTaskPriority=2
      NT_OSAP21_TerApp_B_Task{3..9}: OsTaskPriority=2
      NT_OSAP22_TerApp_B_Task1: OsTaskPriority=2
      NT_OSAP22_TerApp_B_Task{3..9}: OsTaskPriority=2
      NT_OSAP23_TerApp_B_Task1: OsTaskPriority=2
      NT_OSAP23_TerApp_B_Task{3..9}: OsTaskPriority=2
      NT_OSAP24_TerApp_B_Task1: OsTaskPriority=2
      NT_OSAP24_TerApp_B_Task{3..9}: OsTaskPriority=2
      NT_OSAP25_TerApp_B_Task1: OsTaskPriority=2
      NT_OSAP25_TerApp_B_Task{3..9}: OsTaskPriority=2
      NT_OSAP26_TerApp_B_Task1: OsTaskPriority=2
      NT_OSAP26_TerApp_B_Task{3..9}: OsTaskPriority=2
      NT_OSAP27_TerApp_B_Task1: OsTaskPriority=2
      NT_OSAP27_TerApp_B_Task{3..9}: OsTaskPriority=2
      NT_OSAP28_TerApp_B_Task1: OsTaskPriority=2
      NT_OSAP28_TerApp_B_Task{3..9}: OsTaskPriority=2
      NT_OSAP29_TerApp_B_Task1: OsTaskPriority=2
      NT_OSAP29_TerApp_B_Task{3..9}: OsTaskPriority=2
      NT_OSAP30_TerApp_B_Task1: OsTaskPriority=2
      NT_OSAP30_TerApp_B_Task{3..9}: OsTaskPriority=2
      S_IdleTask: OsTaskPriority=1
    62 x OsApplication:
      T_OSAP_MAIN: OsTrusted=true, OsApplicationCoreAssignment=OS_CORE_ID_MASTER, OsAppTaskRef=MainTask
        OsApplicationHooks: OsAppErrorHook=false, OsAppShutdownHook=false, OsAppStartupHook=false
      T_OSAP1_S: OsTrusted=true, OsApplicationCoreAssignment=OS_CORE_ID_SLAVE, OsAppTaskRef=S_IdleTask
        OsApplicationHooks: OsAppErrorHook=false, OsAppShutdownHook=false, OsAppStartupHook=false
      T_OSAP1: OsTrusted=true, OsApplicationCoreAssignment=OS_CORE_ID_MASTER, OsAppTaskRef=T_OSAP1_TerApp_B_Task2
        OsApplicationHooks: OsAppErrorHook=false, OsAppShutdownHook=false, OsAppStartupHook=false
      T_OSAP2: OsTrusted=true, OsApplicationCoreAssignment=OS_CORE_ID_MASTER, OsAppTaskRef=T_OSAP2_TerApp_B_Task2
        OsApplicationHooks: OsAppErrorHook=false, OsAppShutdownHook=false, OsAppStartupHook=false
      T_OSAP3: OsTrusted=true, OsApplicationCoreAssignment=OS_CORE_ID_MASTER, OsAppTaskRef=T_OSAP3_TerApp_B_Task2
        OsApplicationHooks: OsAppErrorHook=false, OsAppShutdownHook=false, OsAppStartupHook=false
      T_OSAP4: OsTrusted=true, OsApplicationCoreAssignment=OS_CORE_ID_MASTER, OsAppTaskRef=T_OSAP4_TerApp_B_Task2
        OsApplicationHooks: OsAppErrorHook=false, OsAppShutdownHook=false, OsAppStartupHook=false
      T_OSAP5: OsTrusted=true, OsApplicationCoreAssignment=OS_CORE_ID_MASTER, OsAppTaskRef=T_OSAP5_TerApp_B_Task2
        OsApplicationHooks: OsAppErrorHook=false, OsAppShutdownHook=false, OsAppStartupHook=false
      T_OSAP6: OsTrusted=true, OsApplicationCoreAssignment=OS_CORE_ID_MASTER, OsAppTaskRef=T_OSAP6_TerApp_B_Task2
        OsApplicationHooks: OsAppErrorHook=false, OsAppShutdownHook=false, OsAppStartupHook=false
      T_OSAP7: OsTrusted=true, OsApplicationCoreAssignment=OS_CORE_ID_MASTER, OsAppTaskRef=T_OSAP7_TerApp_B_Task2
        OsApplicationHooks: OsAppErrorHook=false, OsAppShutdownHook=false, OsAppStartupHook=false
      T_OSAP8: OsTrusted=true, OsApplicationCoreAssignment=OS_CORE_ID_MASTER, OsAppTaskRef=T_OSAP8_TerApp_B_Task2
        OsApplicationHooks: OsAppErrorHook=false, OsAppShutdownHook=false, OsAppStartupHook=false
      T_OSAP9: OsTrusted=true, OsApplicationCoreAssignment=OS_CORE_ID_MASTER, OsAppTaskRef=T_OSAP9_TerApp_B_Task2
        OsApplicationHooks: OsAppErrorHook=false, OsAppShutdownHook=false, OsAppStartupHook=false
      T_OSAP10: OsTrusted=true, OsApplicationCoreAssignment=OS_CORE_ID_MASTER, OsAppTaskRef=T_OSAP10_TerApp_B_Task2
        OsApplicationHooks: OsAppErrorHook=false, OsAppShutdownHook=false, OsAppStartupHook=false
      T_OSAP11: OsTrusted=true, OsApplicationCoreAssignment=OS_CORE_ID_MASTER, OsAppTaskRef=T_OSAP11_TerApp_B_Task2
        OsApplicationHooks: OsAppErrorHook=false, OsAppShutdownHook=false, OsAppStartupHook=false
      T_OSAP12: OsTrusted=true, OsApplicationCoreAssignment=OS_CORE_ID_MASTER, OsAppTaskRef=T_OSAP12_TerApp_B_Task2
        OsApplicationHooks: OsAppErrorHook=false, OsAppShutdownHook=false, OsAppStartupHook=false
      T_OSAP13: OsTrusted=true, OsApplicationCoreAssignment=OS_CORE_ID_MASTER, OsAppTaskRef=T_OSAP13_TerApp_B_Task2
        OsApplicationHooks: OsAppErrorHook=false, OsAppShutdownHook=false, OsAppStartupHook=false
      T_OSAP14: OsTrusted=true, OsApplicationCoreAssignment=OS_CORE_ID_MASTER, OsAppTaskRef=T_OSAP14_TerApp_B_Task2
        OsApplicationHooks: OsAppErrorHook=false, OsAppShutdownHook=false, OsAppStartupHook=false
      T_OSAP15: OsTrusted=true, OsApplicationCoreAssignment=OS_CORE_ID_MASTER, OsAppTaskRef=T_OSAP15_TerApp_B_Task2
        OsApplicationHooks: OsAppErrorHook=false, OsAppShutdownHook=false, OsAppStartupHook=false
      T_OSAP16: OsTrusted=true, OsApplicationCoreAssignment=OS_CORE_ID_MASTER, OsAppTaskRef=T_OSAP16_TerApp_B_Task2
        OsApplicationHooks: OsAppErrorHook=false, OsAppShutdownHook=false, OsAppStartupHook=false
      T_OSAP17: OsTrusted=true, OsApplicationCoreAssignment=OS_CORE_ID_MASTER, OsAppTaskRef=T_OSAP17_TerApp_B_Task2
        OsApplicationHooks: OsAppErrorHook=false, OsAppShutdownHook=false, OsAppStartupHook=false
      T_OSAP18: OsTrusted=true, OsApplicationCoreAssignment=OS_CORE_ID_MASTER, OsAppTaskRef=T_OSAP18_TerApp_B_Task2
        OsApplicationHooks: OsAppErrorHook=false, OsAppShutdownHook=false, OsAppStartupHook=false
      T_OSAP19: OsTrusted=true, OsApplicationCoreAssignment=OS_CORE_ID_MASTER, OsAppTaskRef=T_OSAP19_TerApp_B_Task2
        OsApplicationHooks: OsAppErrorHook=false, OsAppShutdownHook=false, OsAppStartupHook=false
      T_OSAP20: OsTrusted=true, OsApplicationCoreAssignment=OS_CORE_ID_MASTER, OsAppTaskRef=T_OSAP20_TerApp_B_Task2
        OsApplicationHooks: OsAppErrorHook=false, OsAppShutdownHook=false, OsAppStartupHook=false
      T_OSAP21: OsTrusted=true, OsApplicationCoreAssignment=OS_CORE_ID_MASTER, OsAppTaskRef=T_OSAP21_TerApp_B_Task2
        OsApplicationHooks: OsAppErrorHook=false, OsAppShutdownHook=false, OsAppStartupHook=false
      T_OSAP22: OsTrusted=true, OsApplicationCoreAssignment=OS_CORE_ID_MASTER, OsAppTaskRef=T_OSAP22_TerApp_B_Task2
        OsApplicationHooks: OsAppErrorHook=false, OsAppShutdownHook=false, OsAppStartupHook=false
      T_OSAP23: OsTrusted=true, OsApplicationCoreAssignment=OS_CORE_ID_MASTER, OsAppTaskRef=T_OSAP23_TerApp_B_Task2
        OsApplicationHooks: OsAppErrorHook=false, OsAppShutdownHook=false, OsAppStartupHook=false
      T_OSAP24: OsTrusted=true, OsApplicationCoreAssignment=OS_CORE_ID_MASTER, OsAppTaskRef=T_OSAP24_TerApp_B_Task2
        OsApplicationHooks: OsAppErrorHook=false, OsAppShutdownHook=false, OsAppStartupHook=false
      T_OSAP25: OsTrusted=true, OsApplicationCoreAssignment=OS_CORE_ID_MASTER, OsAppTaskRef=T_OSAP25_TerApp_B_Task2
        OsApplicationHooks: OsAppErrorHook=false, OsAppShutdownHook=false, OsAppStartupHook=false
      T_OSAP26: OsTrusted=true, OsApplicationCoreAssignment=OS_CORE_ID_MASTER, OsAppTaskRef=T_OSAP26_TerApp_B_Task2
        OsApplicationHooks: OsAppErrorHook=false, OsAppShutdownHook=false, OsAppStartupHook=false
      T_OSAP27: OsTrusted=true, OsApplicationCoreAssignment=OS_CORE_ID_MASTER, OsAppTaskRef=T_OSAP27_TerApp_B_Task2
        OsApplicationHooks: OsAppErrorHook=false, OsAppShutdownHook=false, OsAppStartupHook=false
      T_OSAP28: OsTrusted=true, OsApplicationCoreAssignment=OS_CORE_ID_MASTER, OsAppTaskRef=T_OSAP28_TerApp_B_Task2
        OsApplicationHooks: OsAppErrorHook=false, OsAppShutdownHook=false, OsAppStartupHook=false
      T_OSAP29: OsTrusted=true, OsApplicationCoreAssignment=OS_CORE_ID_MASTER, OsAppTaskRef=T_OSAP29_TerApp_B_Task2
        OsApplicationHooks: OsAppErrorHook=false, OsAppShutdownHook=false, OsAppStartupHook=false
      T_OSAP30: OsTrusted=true, OsApplicationCoreAssignment=OS_CORE_ID_MASTER, OsAppTaskRef=T_OSAP30_TerApp_B_Task2
        OsApplicationHooks: OsAppErrorHook=false, OsAppShutdownHook=false, OsAppStartupHook=false
      NT_OSAP1: OsTrusted=false, OsApplicationCoreAssignment=OS_CORE_ID_MASTER, OsAppTaskRef=NT_OSAP1_TerApp_B_Task1
        OsApplicationHooks: OsAppErrorHook=false, OsAppShutdownHook=false, OsAppStartupHook=false
      NT_OSAP2: OsTrusted=false, OsApplicationCoreAssignment=OS_CORE_ID_MASTER, OsAppTaskRef=NT_OSAP2_TerApp_B_Task1
        OsApplicationHooks: OsAppErrorHook=false, OsAppShutdownHook=false, OsAppStartupHook=false
      NT_OSAP3: OsTrusted=false, OsApplicationCoreAssignment=OS_CORE_ID_MASTER, OsAppTaskRef=NT_OSAP3_TerApp_B_Task1
        OsApplicationHooks: OsAppErrorHook=false, OsAppShutdownHook=false, OsAppStartupHook=false
      NT_OSAP4: OsTrusted=false, OsApplicationCoreAssignment=OS_CORE_ID_MASTER, OsAppTaskRef=NT_OSAP4_TerApp_B_Task1
        OsApplicationHooks: OsAppErrorHook=false, OsAppShutdownHook=false, OsAppStartupHook=false
      NT_OSAP5: OsTrusted=false, OsApplicationCoreAssignment=OS_CORE_ID_MASTER, OsAppTaskRef=NT_OSAP5_TerApp_B_Task1
        OsApplicationHooks: OsAppErrorHook=false, OsAppShutdownHook=false, OsAppStartupHook=false
      NT_OSAP6: OsTrusted=false, OsApplicationCoreAssignment=OS_CORE_ID_MASTER, OsAppTaskRef=NT_OSAP6_TerApp_B_Task1
        OsApplicationHooks: OsAppErrorHook=false, OsAppShutdownHook=false, OsAppStartupHook=false
      NT_OSAP7: OsTrusted=false, OsApplicationCoreAssignment=OS_CORE_ID_MASTER, OsAppTaskRef=NT_OSAP7_TerApp_B_Task1
        OsApplicationHooks: OsAppErrorHook=false, OsAppShutdownHook=false, OsAppStartupHook=false
      NT_OSAP8: OsTrusted=false, OsApplicationCoreAssignment=OS_CORE_ID_MASTER, OsAppTaskRef=NT_OSAP8_TerApp_B_Task1
        OsApplicationHooks: OsAppErrorHook=false, OsAppShutdownHook=false, OsAppStartupHook=false
      NT_OSAP9: OsTrusted=false, OsApplicationCoreAssignment=OS_CORE_ID_MASTER, OsAppTaskRef=NT_OSAP9_TerApp_B_Task1
        OsApplicationHooks: OsAppErrorHook=false, OsAppShutdownHook=false, OsAppStartupHook=false
      NT_OSAP10: OsTrusted=false, OsApplicationCoreAssignment=OS_CORE_ID_MASTER, OsAppTaskRef=NT_OSAP10_TerApp_B_Task1
        OsApplicationHooks: OsAppErrorHook=false, OsAppShutdownHook=false, OsAppStartupHook=false
      NT_OSAP11: OsTrusted=false, OsApplicationCoreAssignment=OS_CORE_ID_MASTER, OsAppTaskRef=NT_OSAP11_TerApp_B_Task1, OsAppTaskRef=NT_OSAP11_TerApp_B_Task3, OsAppTaskRef=NT_OSAP11_TerApp_B_Task4, OsAppTaskRef=NT_OSAP11_TerApp_B_Task5
        OsApplicationHooks: OsAppErrorHook=false, OsAppShutdownHook=false, OsAppStartupHook=false
      NT_OSAP12: OsTrusted=false, OsApplicationCoreAssignment=OS_CORE_ID_MASTER, OsAppTaskRef=NT_OSAP12_TerApp_B_Task1, OsAppTaskRef=NT_OSAP12_TerApp_B_Task3, OsAppTaskRef=NT_OSAP12_TerApp_B_Task4, OsAppTaskRef=NT_OSAP12_TerApp_B_Task5
        OsApplicationHooks: OsAppErrorHook=false, OsAppShutdownHook=false, OsAppStartupHook=false
      NT_OSAP13: OsTrusted=false, OsApplicationCoreAssignment=OS_CORE_ID_MASTER, OsAppTaskRef=NT_OSAP13_TerApp_B_Task1, OsAppTaskRef=NT_OSAP13_TerApp_B_Task3, OsAppTaskRef=NT_OSAP13_TerApp_B_Task4, OsAppTaskRef=NT_OSAP13_TerApp_B_Task5
        OsApplicationHooks: OsAppErrorHook=false, OsAppShutdownHook=false, OsAppStartupHook=false
      NT_OSAP14: OsTrusted=false, OsApplicationCoreAssignment=OS_CORE_ID_MASTER, OsAppTaskRef=NT_OSAP14_TerApp_B_Task1, OsAppTaskRef=NT_OSAP14_TerApp_B_Task3, OsAppTaskRef=NT_OSAP14_TerApp_B_Task4, OsAppTaskRef=NT_OSAP14_TerApp_B_Task5
        OsApplicationHooks: OsAppErrorHook=false, OsAppShutdownHook=false, OsAppStartupHook=false
      NT_OSAP15: OsTrusted=false, OsApplicationCoreAssignment=OS_CORE_ID_MASTER, OsAppTaskRef=NT_OSAP15_TerApp_B_Task1, OsAppTaskRef=NT_OSAP15_TerApp_B_Task3, OsAppTaskRef=NT_OSAP15_TerApp_B_Task4, OsAppTaskRef=NT_OSAP15_TerApp_B_Task5
        OsApplicationHooks: OsAppErrorHook=false, OsAppShutdownHook=false, OsAppStartupHook=false
      NT_OSAP16: OsTrusted=false, OsApplicationCoreAssignment=OS_CORE_ID_MASTER, OsAppTaskRef=NT_OSAP16_TerApp_B_Task1, OsAppTaskRef=NT_OSAP16_TerApp_B_Task3, OsAppTaskRef=NT_OSAP16_TerApp_B_Task4, OsAppTaskRef=NT_OSAP16_TerApp_B_Task5
        OsApplicationHooks: OsAppErrorHook=false, OsAppShutdownHook=false, OsAppStartupHook=false
      NT_OSAP17: OsTrusted=false, OsApplicationCoreAssignment=OS_CORE_ID_MASTER, OsAppTaskRef=NT_OSAP17_TerApp_B_Task1, OsAppTaskRef=NT_OSAP17_TerApp_B_Task3, OsAppTaskRef=NT_OSAP17_TerApp_B_Task4, OsAppTaskRef=NT_OSAP17_TerApp_B_Task5
        OsApplicationHooks: OsAppErrorHook=false, OsAppShutdownHook=false, OsAppStartupHook=false
      NT_OSAP18: OsTrusted=false, OsApplicationCoreAssignment=OS_CORE_ID_MASTER, OsAppTaskRef=NT_OSAP18_TerApp_B_Task1, OsAppTaskRef=NT_OSAP18_TerApp_B_Task3, OsAppTaskRef=NT_OSAP18_TerApp_B_Task4, OsAppTaskRef=NT_OSAP18_TerApp_B_Task5
        OsApplicationHooks: OsAppErrorHook=false, OsAppShutdownHook=false, OsAppStartupHook=false
      NT_OSAP19: OsTrusted=false, OsApplicationCoreAssignment=OS_CORE_ID_MASTER, OsAppTaskRef=NT_OSAP19_TerApp_B_Task1, OsAppTaskRef=NT_OSAP19_TerApp_B_Task3, OsAppTaskRef=NT_OSAP19_TerApp_B_Task4, OsAppTaskRef=NT_OSAP19_TerApp_B_Task5
        OsApplicationHooks: OsAppErrorHook=false, OsAppShutdownHook=false, OsAppStartupHook=false
      NT_OSAP20: OsTrusted=false, OsApplicationCoreAssignment=OS_CORE_ID_MASTER, OsAppTaskRef=NT_OSAP20_TerApp_B_Task1, OsAppTaskRef=NT_OSAP20_TerApp_B_Task3, OsAppTaskRef=NT_OSAP20_TerApp_B_Task4, OsAppTaskRef=NT_OSAP20_TerApp_B_Task5
        OsApplicationHooks: OsAppErrorHook=false, OsAppShutdownHook=false, OsAppStartupHook=false
      NT_OSAP21: OsTrusted=false, OsApplicationCoreAssignment=OS_CORE_ID_MASTER, OsAppTaskRef=NT_OSAP21_TerApp_B_Task1, OsAppTaskRef=NT_OSAP21_TerApp_B_Task3, OsAppTaskRef=NT_OSAP21_TerApp_B_Task4, OsAppTaskRef=NT_OSAP21_TerApp_B_Task5, OsAppTaskRef=NT_OSAP21_TerApp_B_Task6, OsAppTaskRef=NT_OSAP21_TerApp_B_Task7, OsAppTaskRef=NT_OSAP21_TerApp_B_Task8, OsAppTaskRef=NT_OSAP21_TerApp_B_Task9
        OsApplicationHooks: OsAppErrorHook=false, OsAppShutdownHook=false, OsAppStartupHook=false
      NT_OSAP22: OsTrusted=false, OsApplicationCoreAssignment=OS_CORE_ID_MASTER, OsAppTaskRef=NT_OSAP22_TerApp_B_Task1, OsAppTaskRef=NT_OSAP22_TerApp_B_Task3, OsAppTaskRef=NT_OSAP22_TerApp_B_Task4, OsAppTaskRef=NT_OSAP22_TerApp_B_Task5, OsAppTaskRef=NT_OSAP22_TerApp_B_Task6, OsAppTaskRef=NT_OSAP22_TerApp_B_Task7, OsAppTaskRef=NT_OSAP22_TerApp_B_Task8, OsAppTaskRef=NT_OSAP22_TerApp_B_Task9
        OsApplicationHooks: OsAppErrorHook=false, OsAppShutdownHook=false, OsAppStartupHook=false
      NT_OSAP23: OsTrusted=false, OsApplicationCoreAssignment=OS_CORE_ID_MASTER, OsAppTaskRef=NT_OSAP23_TerApp_B_Task1, OsAppTaskRef=NT_OSAP23_TerApp_B_Task3, OsAppTaskRef=NT_OSAP23_TerApp_B_Task4, OsAppTaskRef=NT_OSAP23_TerApp_B_Task5, OsAppTaskRef=NT_OSAP23_TerApp_B_Task6, OsAppTaskRef=NT_OSAP23_TerApp_B_Task7, OsAppTaskRef=NT_OSAP23_TerApp_B_Task8, OsAppTaskRef=NT_OSAP23_TerApp_B_Task9
        OsApplicationHooks: OsAppErrorHook=false, OsAppShutdownHook=false, OsAppStartupHook=false
      NT_OSAP24: OsTrusted=false, OsApplicationCoreAssignment=OS_CORE_ID_MASTER, OsAppTaskRef=NT_OSAP24_TerApp_B_Task1, OsAppTaskRef=NT_OSAP24_TerApp_B_Task3, OsAppTaskRef=NT_OSAP24_TerApp_B_Task4, OsAppTaskRef=NT_OSAP24_TerApp_B_Task5, OsAppTaskRef=NT_OSAP24_TerApp_B_Task6, OsAppTaskRef=NT_OSAP24_TerApp_B_Task7, OsAppTaskRef=NT_OSAP24_TerApp_B_Task8, OsAppTaskRef=NT_OSAP24_TerApp_B_Task9
        OsApplicationHooks: OsAppErrorHook=false, OsAppShutdownHook=false, OsAppStartupHook=false
      NT_OSAP25: OsTrusted=false, OsApplicationCoreAssignment=OS_CORE_ID_MASTER, OsAppTaskRef=NT_OSAP25_TerApp_B_Task1, OsAppTaskRef=NT_OSAP25_TerApp_B_Task3, OsAppTaskRef=NT_OSAP25_TerApp_B_Task4, OsAppTaskRef=NT_OSAP25_TerApp_B_Task5, OsAppTaskRef=NT_OSAP25_TerApp_B_Task6, OsAppTaskRef=NT_OSAP25_TerApp_B_Task7, OsAppTaskRef=NT_OSAP25_TerApp_B_Task8, OsAppTaskRef=NT_OSAP25_TerApp_B_Task9
        OsApplicationHooks: OsAppErrorHook=false, OsAppShutdownHook=false, OsAppStartupHook=false
      NT_OSAP26: OsTrusted=false, OsApplicationCoreAssignment=OS_CORE_ID_MASTER, OsAppTaskRef=NT_OSAP26_TerApp_B_Task1, OsAppTaskRef=NT_OSAP26_TerApp_B_Task3, OsAppTaskRef=NT_OSAP26_TerApp_B_Task4, OsAppTaskRef=NT_OSAP26_TerApp_B_Task5, OsAppTaskRef=NT_OSAP26_TerApp_B_Task6, OsAppTaskRef=NT_OSAP26_TerApp_B_Task7, OsAppTaskRef=NT_OSAP26_TerApp_B_Task8, OsAppTaskRef=NT_OSAP26_TerApp_B_Task9
        OsApplicationHooks: OsAppErrorHook=false, OsAppShutdownHook=false, OsAppStartupHook=false
      NT_OSAP27: OsTrusted=false, OsApplicationCoreAssignment=OS_CORE_ID_MASTER, OsAppTaskRef=NT_OSAP27_TerApp_B_Task1, OsAppTaskRef=NT_OSAP27_TerApp_B_Task3, OsAppTaskRef=NT_OSAP27_TerApp_B_Task4, OsAppTaskRef=NT_OSAP27_TerApp_B_Task5, OsAppTaskRef=NT_OSAP27_TerApp_B_Task6, OsAppTaskRef=NT_OSAP27_TerApp_B_Task7, OsAppTaskRef=NT_OSAP27_TerApp_B_Task8, OsAppTaskRef=NT_OSAP27_TerApp_B_Task9
        OsApplicationHooks: OsAppErrorHook=false, OsAppShutdownHook=false, OsAppStartupHook=false
      NT_OSAP28: OsTrusted=false, OsApplicationCoreAssignment=OS_CORE_ID_MASTER, OsAppTaskRef=NT_OSAP28_TerApp_B_Task1, OsAppTaskRef=NT_OSAP28_TerApp_B_Task3, OsAppTaskRef=NT_OSAP28_TerApp_B_Task4, OsAppTaskRef=NT_OSAP28_TerApp_B_Task5, OsAppTaskRef=NT_OSAP28_TerApp_B_Task6, OsAppTaskRef=NT_OSAP28_TerApp_B_Task7, OsAppTaskRef=NT_OSAP28_TerApp_B_Task8, OsAppTaskRef=NT_OSAP28_TerApp_B_Task9
        OsApplicationHooks: OsAppErrorHook=false, OsAppShutdownHook=false, OsAppStartupHook=false
      NT_OSAP29: OsTrusted=false, OsApplicationCoreAssignment=OS_CORE_ID_MASTER, OsAppTaskRef=NT_OSAP29_TerApp_B_Task1, OsAppTaskRef=NT_OSAP29_TerApp_B_Task3, OsAppTaskRef=NT_OSAP29_TerApp_B_Task4, OsAppTaskRef=NT_OSAP29_TerApp_B_Task5, OsAppTaskRef=NT_OSAP29_TerApp_B_Task6, OsAppTaskRef=NT_OSAP29_TerApp_B_Task7, OsAppTaskRef=NT_OSAP29_TerApp_B_Task8, OsAppTaskRef=NT_OSAP29_TerApp_B_Task9
        OsApplicationHooks: OsAppErrorHook=false, OsAppShutdownHook=false, OsAppStartupHook=false
      NT_OSAP30: OsTrusted=false, OsApplicationCoreAssignment=OS_CORE_ID_MASTER, OsAppTaskRef=NT_OSAP30_TerApp_B_Task1, OsAppTaskRef=NT_OSAP30_TerApp_B_Task3, OsAppTaskRef=NT_OSAP30_TerApp_B_Task4, OsAppTaskRef=NT_OSAP30_TerApp_B_Task5, OsAppTaskRef=NT_OSAP30_TerApp_B_Task6, OsAppTaskRef=NT_OSAP30_TerApp_B_Task7, OsAppTaskRef=NT_OSAP30_TerApp_B_Task8, OsAppTaskRef=NT_OSAP30_TerApp_B_Task9
        OsApplicationHooks: OsAppErrorHook=false, OsAppShutdownHook=false, OsAppStartupHook=false
