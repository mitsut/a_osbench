AUTOSAR XML (schema 4-0-3)
package /Ecuc
  module config Os: ecuc-def-edition=4.2.0, implementation-config-variant=VARIANT-PRE-COMPILE
    3 x OsInclude:
      OsInclude1: OsIncludeFileName=perf_general.h
      OsInclude2: OsIncludeFileName=test_target_lib.h
      OsInclude3: OsIncludeFileName=perf_general_nt.h
    OsOS: OsNumberOfCores=2, OsStackMonitoring=false, OsUseGetServiceId=true, OsUseParameterAccess=true, OsScalabilityClass=SC3, OsStatus=EXTENDED
      OsHooks: OsErrorHook=true, OsPostTaskHook=false, OsPreTaskHook=false, OsProtectionHook=true, OsShutdownHook=false, OsStartupHook=false
    MainApp (OsAppMode)
    4 x OsIsr, all with OsIsrCategory=CATEGORY_2, OsIsrInterruptSource=ENABLE, OsIsrInterruptPriority=INTPRI_TIMER_NUM, OsIsrStackSize=ISR_STACK_SIZE:
      T_OSAP{1..4}_TerApp_F_Isr2: OsIsrInterruptNumber=INTNO_TERAPP_F{1..4}
    189 x OsTask, all with OsTaskActivation=1, OsTaskStackSize=TASK_STACK_SIZE, OsTaskSchedule=FULL:
      MainTask: OsTaskPriority=1
        OsTaskAutostart: OsTaskAppModeRef=MainApp
      T_OSAP1_TerApp_D_Task3: OsTaskPriority=4
      T_OSAP1_TerApp_E_Task2: OsTaskPriority=3
      NT_OSAP1_Tfn_Task1: OsTaskPriority=2
      NT_OSAP1_ChkMem_Task1: OsTaskPriority=2
      NT_OSAP1_TerApp_C_Task1: OsTaskPriority=2
      NT_OSAP1_TerApp_C_ReTask2: OsTaskPriority=3
      NT_OSAP1_TerApp_C_Task3: OsTaskPriority=4
      NT_OSAP1_TerApp_D_Task1: OsTaskPriority=2
      NT_OSAP1_TerApp_D_ReTask2: OsTaskPriority=3
      NT_OSAP1_TerApp_E_Task1: OsTaskPriority=2
      NT_OSAP1_TerApp_E_ReTask3: OsTaskPriority=4
      NT_OSAP1_TerApp_E_ResetTask: OsTaskPriority=5
      NT_OSAP1_TerApp_F_Task1: OsTaskPriority=2
      NT_OSAP1_TerApp_F_ReTask2: OsTaskPriority=3
      T_OSAP1_M_TerApp_MC_Task1: OsTaskPriority=2
      NT_OSAP1_S_TerApp_MC_Task2: OsTaskPriority=3
      NT_OSAP1_S_TerApp_MC_ReTask3: OsTaskPriority=4
      T_OSAP2_TerApp_D_Task3: OsTaskPriority=4
      T_OSAP2_TerApp_E_Task2: OsTaskPriority=3
      NT_OSAP2_TerApp_C_Task1: OsTaskPriority=2
      NT_OSAP2_TerApp_C_ReTask2: OsTaskPriority=3
      NT_OSAP2_TerApp_C_Task3: OsTaskPriority=4
      NT_OSAP2_TerApp_C_Task{4..6}: OsTaskPriority=2
      NT_OSAP2_TerApp_D_Task1: OsTaskPriority=2
      NT_OSAP2_TerApp_D_ReTask2: OsTaskPriority=3
      NT_OSAP2_TerApp_D_Task{4..6}: OsTaskPriority=2
      NT_OSAP2_TerApp_E_Task1: OsTaskPriority=2
      NT_OSAP2_TerApp_E_ReTask3: OsTaskPriority=4
      NT_OSAP2_TerApp_E_ResetTask: OsTaskPriority=5
      NT_OSAP2_TerApp_E_Task{4..6}: OsTaskPriority=2
      NT_OSAP2_TerApp_F_Task1: OsTaskPriority=2
      NT_OSAP2_TerApp_F_ReTask2: OsTaskPriority=3
      NT_OSAP2_TerApp_F_Task{3..5}: OsTaskPriority=2
      T_OSAP2_M_TerApp_MC_Task1: OsTaskPriority=2
      NT_OSAP2_S_TerApp_MC_Task2: OsTaskPriority=3
      NT_OSAP2_S_TerApp_MC_ReTask3: OsTaskPriority=4
      NT_OSAP2_S_TerApp_MC_Task{4..6}: OsTaskPriority=3
      T_OSAP3_TerApp_D_Task3: OsTaskPriority=4
      T_OSAP3_TerApp_E_Task2: OsTaskPriority=3
      NT_OSAP3_TerApp_C_Task1: OsTaskPriority=2
      NT_OSAP3_TerApp_C_ReTask2: OsTaskPriority=3
      NT_OSAP3_TerApp_C_Task3: OsTaskPriority=4
      NT_OSAP3_TerApp_C_Task{4..10}: OsTaskPriority=2
      NT_OSAP3_TerApp_D_Task1: OsTaskPriority=2
      NT_OSAP3_TerApp_D_ReTask2: OsTaskPriority=3
      NT_OSAP3_TerApp_D_Task{4..10}: OsTaskPriority=2
      NT_OSAP3_TerApp_E_Task1: OsTaskPriority=2
      NT_OSAP3_TerApp_E_ReTask3: OsTaskPriority=4
      NT_OSAP3_TerApp_E_ResetTask: OsTaskPriority=5
      NT_OSAP3_TerApp_E_Task{4..10}: OsTaskPriority=2
      NT_OSAP3_TerApp_F_Task1: OsTaskPriority=2
      NT_OSAP3_TerApp_F_ReTask2: OsTaskPriority=3
      NT_OSAP3_TerApp_F_Task{3..9}: OsTaskPriority=2
      T_OSAP3_M_TerApp_MC_Task1: OsTaskPriority=2
      NT_OSAP3_S_TerApp_MC_Task2: OsTaskPriority=3
      NT_OSAP3_S_TerApp_MC_ReTask3: OsTaskPriority=4
      NT_OSAP3_S_TerApp_MC_Task{4..10}: OsTaskPriority=3
      T_OSAP4_TerApp_D_Task3: OsTaskPriority=4
      T_OSAP4_TerApp_E_Task2: OsTaskPriority=3
      T_OSAP4_M_TerApp_MC_Task1: OsTaskPriority=2
      NT_OSAP4_TerApp_C_Task1: OsTaskPriority=2
      NT_OSAP4_TerApp_C_ReTask2: OsTaskPriority=3
      NT_OSAP4_TerApp_C_Task3: OsTaskPriority=4
      NT_OSAP4_TerApp_C_Task{4..18}: OsTaskPriority=2
      NT_OSAP4_TerApp_D_Task1: OsTaskPriority=2
      NT_OSAP4_TerApp_D_ReTask2: OsTaskPriority=3
      NT_OSAP4_TerApp_D_Task{4..18}: OsTaskPriority=2
      NT_OSAP4_TerApp_E_Task1: OsTaskPriority=2
      NT_OSAP4_TerApp_E_ReTask3: OsTaskPriority=4
      NT_OSAP4_TerApp_E_ResetTask: OsTaskPriority=5
      NT_OSAP4_TerApp_E_Task{4..18}: OsTaskPriority=2
      NT_OSAP4_TerApp_F_Task1: OsTaskPriority=2
      NT_OSAP4_TerApp_F_ReTask2: OsTaskPriority=3
      NT_OSAP4_TerApp_F_Task{3..17}: OsTaskPriority=2
      NT_OSAP4_S_TerApp_MC_Task2: OsTaskPriority=3
      NT_OSAP4_S_TerApp_MC_ReTask3: OsTaskPriority=4
      NT_OSAP4_S_TerApp_MC_Task{4..18}: OsTaskPriority=3
      S_IdleTask: OsTaskPriority=1
    28 x OsApplication:
      T_OSAP_MAIN: OsTrusted=true, OsApplicationCoreAssignment=OS_CORE_ID_MASTER, OsAppTaskRef=MainTask
        OsApplicationHooks: OsAppErrorHook=false, OsAppShutdownHook=false, OsAppStartupHook=false
      T_OSAP1: OsTrusted=true, OsApplicationCoreAssignment=OS_CORE_ID_MASTER, OsAppTaskRef=T_OSAP1_TerApp_D_Task3, OsAppTaskRef=T_OSAP1_TerApp_E_Task2, OsAppIsrRef=T_OSAP1_TerApp_F_Isr2
        OsApplicationHooks: OsAppErrorHook=false, OsAppShutdownHook=false, OsAppStartupHook=false
        4 x OsApplicationTrustedFunction:
          TFN_TFN_1: OsTrustedFunctionName=TRUSTED_tfn_tfn1
          TFN_TFN_2: OsTrustedFunctionName=TRUSTED_tfn_tfn2
          TRIGGER_TERAPP_ISR2_TFN1: OsTrustedFunctionName=TRUSTED_terapp_isr2_tfn1
          CHKMEM_TFN1: OsTrustedFunctionName=TRUSTED_ChkMem_tfn1
      T_OSAP1_M: OsTrusted=true, OsApplicationCoreAssignment=OS_CORE_ID_MASTER, OsAppTaskRef=T_OSAP1_M_TerApp_MC_Task1
        OsApplicationHooks: OsAppErrorHook=false, OsAppShutdownHook=false, OsAppStartupHook=false
      T_OSAP1_S: OsTrusted=true, OsApplicationCoreAssignment=OS_CORE_ID_SLAVE, OsAppTaskRef=S_IdleTask
        OsApplicationHooks: OsAppErrorHook=false, OsAppShutdownHook=false, OsAppStartupHook=false
      NT_OSAP1: OsTrusted=false, OsApplicationCoreAssignment=OS_CORE_ID_MASTER, OsAppTaskRef=NT_OSAP1_Tfn_Task1, OsAppTaskRef=NT_OSAP1_ChkMem_Task1
        OsApplicationHooks: OsAppErrorHook=false, OsAppShutdownHook=false, OsAppStartupHook=false
      NT_OSAP1_TERAPP_C: OsTrusted=false, OsApplicationCoreAssignment=OS_CORE_ID_MASTER, OsAppTaskRef=NT_OSAP1_TerApp_C_Task1, OsAppTaskRef=NT_OSAP1_TerApp_C_ReTask2, OsAppTaskRef=NT_OSAP1_TerApp_C_Task3, OsRestartTask=NT_OSAP1_TerApp_C_ReTask2
        OsApplicationHooks: OsAppErrorHook=false, OsAppShutdownHook=false, OsAppStartupHook=false
      NT_OSAP1_TERAPP_D: OsTrusted=false, OsApplicationCoreAssignment=OS_CORE_ID_MASTER, OsAppTaskRef=NT_OSAP1_TerApp_D_Task1, OsAppTaskRef=NT_OSAP1_TerApp_D_ReTask2, OsRestartTask=NT_OSAP1_TerApp_D_ReTask2
        OsApplicationHooks: OsAppErrorHook=false, OsAppShutdownHook=false, OsAppStartupHook=false
      NT_OSAP1_TERAPP_E: OsTrusted=false, OsApplicationCoreAssignment=OS_CORE_ID_MASTER, OsAppTaskRef=NT_OSAP1_TerApp_E_Task1, OsAppTaskRef=NT_OSAP1_TerApp_E_ReTask3, OsAppTaskRef=NT_OSAP1_TerApp_E_ResetTask, OsRestartTask=NT_OSAP1_TerApp_E_ReTask3
        OsApplicationHooks: OsAppErrorHook=false, OsAppShutdownHook=false, OsAppStartupHook=false
      NT_OSAP1_TERAPP_F: OsTrusted=false, OsApplicationCoreAssignment=OS_CORE_ID_MASTER, OsAppTaskRef=NT_OSAP1_TerApp_F_Task1, OsAppTaskRef=NT_OSAP1_TerApp_F_ReTask2, OsRestartTask=NT_OSAP1_TerApp_F_ReTask2
        OsApplicationHooks: OsAppErrorHook=false, OsAppShutdownHook=false, OsAppStartupHook=false
      T_OSAP2: OsTrusted=true, OsApplicationCoreAssignment=OS_CORE_ID_MASTER, OsAppTaskRef=T_OSAP2_TerApp_D_Task3, OsAppTaskRef=T_OSAP2_TerApp_E_Task2, OsAppTaskRef=T_OSAP2_M_TerApp_MC_Task1, OsAppIsrRef=T_OSAP2_TerApp_F_Isr2
        OsApplicationHooks: OsAppErrorHook=false, OsAppShutdownHook=false, OsAppStartupHook=false
        TRIGGER_TERAPP_ISR2_TFN2 (OsApplicationTrustedFunction): OsTrustedFunctionName=TRUSTED_terapp_isr2_tfn2
      NT_OSAP2_TERAPP_C: OsTrusted=false, OsApplicationCoreAssignment=OS_CORE_ID_MASTER, OsAppTaskRef=NT_OSAP2_TerApp_C_Task1, OsAppTaskRef=NT_OSAP2_TerApp_C_ReTask2, OsAppTaskRef=NT_OSAP2_TerApp_C_Task3, OsAppTaskRef=NT_OSAP2_TerApp_C_Task4, OsAppTaskRef=NT_OSAP2_TerApp_C_Task5, OsAppTaskRef=NT_OSAP2_TerApp_C_Task6, OsRestartTask=NT_OSAP2_TerApp_C_ReTask2
        OsApplicationHooks: OsAppErrorHook=false, OsAppShutdownHook=false, OsAppStartupHook=false
      NT_OSAP2_TERAPP_D: OsTrusted=false, OsApplicationCoreAssignment=OS_CORE_ID_MASTER, OsAppTaskRef=NT_OSAP2_TerApp_D_Task1, OsAppTaskRef=NT_OSAP2_TerApp_D_ReTask2, OsAppTaskRef=NT_OSAP2_TerApp_D_Task4, OsAppTaskRef=NT_OSAP2_TerApp_D_Task5, OsAppTaskRef=NT_OSAP2_TerApp_D_Task6, OsRestartTask=NT_OSAP2_TerApp_D_ReTask2
        OsApplicationHooks: OsAppErrorHook=false, OsAppShutdownHook=false, OsAppStartupHook=false
      NT_OSAP2_TERAPP_E: OsTrusted=false, OsApplicationCoreAssignment=OS_CORE_ID_MASTER, OsAppTaskRef=NT_OSAP2_TerApp_E_Task1, OsAppTaskRef=NT_OSAP2_TerApp_E_ReTask3, OsAppTaskRef=NT_OSAP2_TerApp_E_ResetTask, OsAppTaskRef=NT_OSAP2_TerApp_E_Task4, OsAppTaskRef=NT_OSAP2_TerApp_E_Task5, OsAppTaskRef=NT_OSAP2_TerApp_E_Task6, OsRestartTask=NT_OSAP2_TerApp_E_ReTask3
        OsApplicationHooks: OsAppErrorHook=false, OsAppShutdownHook=false, OsAppStartupHook=false
      NT_OSAP2_TERAPP_F: OsTrusted=false, OsApplicationCoreAssignment=OS_CORE_ID_MASTER, OsAppTaskRef=NT_OSAP2_TerApp_F_Task1, OsAppTaskRef=NT_OSAP2_TerApp_F_ReTask2, OsAppTaskRef=NT_OSAP2_TerApp_F_Task3, OsAppTaskRef=NT_OSAP2_TerApp_F_Task4, OsAppTaskRef=NT_OSAP2_TerApp_F_Task5, OsRestartTask=NT_OSAP2_TerApp_F_ReTask2
        OsApplicationHooks: OsAppErrorHook=false, OsAppShutdownHook=false, OsAppStartupHook=false
      T_OSAP3: OsTrusted=true, OsApplicationCoreAssignment=OS_CORE_ID_MASTER, OsAppTaskRef=T_OSAP3_TerApp_D_Task3, OsAppTaskRef=T_OSAP3_TerApp_E_Task2, OsAppTaskRef=T_OSAP3_M_TerApp_MC_Task1, OsAppIsrRef=T_OSAP3_TerApp_F_Isr2
        OsApplicationHooks: OsAppErrorHook=false, OsAppShutdownHook=false, OsAppStartupHook=false
        TRIGGER_TERAPP_ISR2_TFN3 (OsApplicationTrustedFunction): OsTrustedFunctionName=TRUSTED_terapp_isr2_tfn3
      NT_OSAP3_TERAPP_C: OsTrusted=false, OsApplicationCoreAssignment=OS_CORE_ID_MASTER, OsAppTaskRef=NT_OSAP3_TerApp_C_Task1, OsAppTaskRef=NT_OSAP3_TerApp_C_ReTask2, OsAppTaskRef=NT_OSAP3_TerApp_C_Task3, OsAppTaskRef=NT_OSAP3_TerApp_C_Task4, OsAppTaskRef=NT_OSAP3_TerApp_C_Task5, OsAppTaskRef=NT_OSAP3_TerApp_C_Task6, OsAppTaskRef=NT_OSAP3_TerApp_C_Task7, OsAppTaskRef=NT_OSAP3_TerApp_C_Task8, OsAppTaskRef=NT_OSAP3_TerApp_C_Task9, OsAppTaskRef=NT_OSAP3_TerApp_C_Task10, OsRestartTask=NT_OSAP3_TerApp_C_ReTask2
        OsApplicationHooks: OsAppErrorHook=false, OsAppShutdownHook=false, OsAppStartupHook=false
      NT_OSAP3_TERAPP_D: OsTrusted=false, OsApplicationCoreAssignment=OS_CORE_ID_MASTER, OsAppTaskRef=NT_OSAP3_TerApp_D_Task1, OsAppTaskRef=NT_OSAP3_TerApp_D_ReTask2, OsAppTaskRef=NT_OSAP3_TerApp_D_Task4, OsAppTaskRef=NT_OSAP3_TerApp_D_Task5, OsAppTaskRef=NT_OSAP3_TerApp_D_Task6, OsAppTaskRef=NT_OSAP3_TerApp_D_Task7, OsAppTaskRef=NT_OSAP3_TerApp_D_Task8, OsAppTaskRef=NT_OSAP3_TerApp_D_Task9, OsAppTaskRef=NT_OSAP3_TerApp_D_Task10, OsRestartTask=NT_OSAP3_TerApp_D_ReTask2
        OsApplicationHooks: OsAppErrorHook=false, OsAppShutdownHook=false, OsAppStartupHook=false
      NT_OSAP3_TERAPP_E: OsTrusted=false, OsApplicationCoreAssignment=OS_CORE_ID_MASTER, OsAppTaskRef=NT_OSAP3_TerApp_E_Task1, OsAppTaskRef=NT_OSAP3_TerApp_E_ReTask3, OsAppTaskRef=NT_OSAP3_TerApp_E_ResetTask, OsAppTaskRef=NT_OSAP3_TerApp_E_Task4, OsAppTaskRef=NT_OSAP3_TerApp_E_Task5, OsAppTaskRef=NT_OSAP3_TerApp_E_Task6, OsAppTaskRef=NT_OSAP3_TerApp_E_Task7, OsAppTaskRef=NT_OSAP3_TerApp_E_Task8, OsAppTaskRef=NT_OSAP3_TerApp_E_Task9, OsAppTaskRef=NT_OSAP3_TerApp_E_Task10, OsRestartTask=NT_OSAP3_TerApp_E_ReTask3
        OsApplicationHooks: OsAppErrorHook=false, OsAppShutdownHook=false, OsAppStartupHook=false
      NT_OSAP3_TERAPP_F: OsTrusted=false, OsApplicationCoreAssignment=OS_CORE_ID_MASTER, OsAppTaskRef=NT_OSAP3_TerApp_F_Task1, OsAppTaskRef=NT_OSAP3_TerApp_F_ReTask2, OsAppTaskRef=NT_OSAP3_TerApp_F_Task3, OsAppTaskRef=NT_OSAP3_TerApp_F_Task4, OsAppTaskRef=NT_OSAP3_TerApp_F_Task5, OsAppTaskRef=NT_OSAP3_TerApp_F_Task6, OsAppTaskRef=NT_OSAP3_TerApp_F_Task7, OsAppTaskRef=NT_OSAP3_TerApp_F_Task8, OsAppTaskRef=NT_OSAP3_TerApp_F_Task9, OsRestartTask=NT_OSAP3_TerApp_F_ReTask2
        OsApplicationHooks: OsAppErrorHook=false, OsAppShutdownHook=false, OsAppStartupHook=false
      T_OSAP4: OsTrusted=true, OsApplicationCoreAssignment=OS_CORE_ID_MASTER, OsAppTaskRef=T_OSAP4_TerApp_D_Task3, OsAppTaskRef=T_OSAP4_TerApp_E_Task2, OsAppTaskRef=T_OSAP4_M_TerApp_MC_Task1, OsAppIsrRef=T_OSAP4_TerApp_F_Isr2
        OsApplicationHooks: OsAppErrorHook=false, OsAppShutdownHook=false, OsAppStartupHook=false
        TRIGGER_TERAPP_ISR2_TFN4 (OsApplicationTrustedFunction): OsTrustedFunctionName=TRUSTED_terapp_isr2_tfn4
      NT_OSAP4_TERAPP_C: OsTrusted=false, OsApplicationCoreAssignment=OS_CORE_ID_MASTER, OsAppTaskRef=NT_OSAP4_TerApp_C_Task1, OsAppTaskRef=NT_OSAP4_TerApp_C_ReTask2, OsAppTaskRef=NT_OSAP4_TerApp_C_Task3, OsAppTaskRef=NT_OSAP4_TerApp_C_Task4, OsAppTaskRef=NT_OSAP4_TerApp_C_Task5, OsAppTaskRef=NT_OSAP4_TerApp_C_Task6, OsAppTaskRef=NT_OSAP4_TerApp_C_Task7, OsAppTaskRef=NT_OSAP4_TerApp_C_Task8, OsAppTaskRef=NT_OSAP4_TerApp_C_Task9, OsAppTaskRef=NT_OSAP4_TerApp_C_Task10, OsAppTaskRef=NT_OSAP4_TerApp_C_Task11, OsAppTaskRef=NT_OSAP4_TerApp_C_Task12, OsAppTaskRef=NT_OSAP4_TerApp_C_Task13, OsAppTaskRef=NT_OSAP4_TerApp_C_Task14, OsAppTaskRef=NT_OSAP4_TerApp_C_Task15, OsAppTaskRef=NT_OSAP4_TerApp_C_Task16, OsAppTaskRef=NT_OSAP4_TerApp_C_Task17, OsAppTaskRef=NT_OSAP4_TerApp_C_Task18, OsRestartTask=NT_OSAP4_TerApp_C_ReTask2
        OsApplicationHooks: OsAppErrorHook=false, OsAppShutdownHook=false, OsAppStartupHook=false
      NT_OSAP4_TERAPP_D: OsTrusted=false, OsApplicationCoreAssignment=OS_CORE_ID_MASTER, OsAppTaskRef=NT_OSAP4_TerApp_D_Task1, OsAppTaskRef=NT_OSAP4_TerApp_D_ReTask2, OsAppTaskRef=NT_OSAP4_TerApp_D_Task4, OsAppTaskRef=NT_OSAP4_TerApp_D_Task5, OsAppTaskRef=NT_OSAP4_TerApp_D_Task6, OsAppTaskRef=NT_OSAP4_TerApp_D_Task7, OsAppTaskRef=NT_OSAP4_TerApp_D_Task8, OsAppTaskRef=NT_OSAP4_TerApp_D_Task9, OsAppTaskRef=NT_OSAP4_TerApp_D_Task10, OsAppTaskRef=NT_OSAP4_TerApp_D_Task11, OsAppTaskRef=NT_OSAP4_TerApp_D_Task12, OsAppTaskRef=NT_OSAP4_TerApp_D_Task13, OsAppTaskRef=NT_OSAP4_TerApp_D_Task14, OsAppTaskRef=NT_OSAP4_TerApp_D_Task15, OsAppTaskRef=NT_OSAP4_TerApp_D_Task16, OsAppTaskRef=NT_OSAP4_TerApp_D_Task17, OsAppTaskRef=NT_OSAP4_TerApp_D_Task18, OsRestartTask=NT_OSAP4_TerApp_D_ReTask2
        OsApplicationHooks: OsAppErrorHook=false, OsAppShutdownHook=false, OsAppStartupHook=false
      NT_OSAP4_TERAPP_E: OsTrusted=false, OsApplicationCoreAssignment=OS_CORE_ID_MASTER, OsAppTaskRef=NT_OSAP4_TerApp_E_Task1, OsAppTaskRef=NT_OSAP4_TerApp_E_ReTask3, OsAppTaskRef=NT_OSAP4_TerApp_E_ResetTask, OsAppTaskRef=NT_OSAP4_TerApp_E_Task4, OsAppTaskRef=NT_OSAP4_TerApp_E_Task5, OsAppTaskRef=NT_OSAP4_TerApp_E_Task6, OsAppTaskRef=NT_OSAP4_TerApp_E_Task7, OsAppTaskRef=NT_OSAP4_TerApp_E_Task8, OsAppTaskRef=NT_OSAP4_TerApp_E_Task9, OsAppTaskRef=NT_OSAP4_TerApp_E_Task10, OsAppTaskRef=NT_OSAP4_TerApp_E_Task11, OsAppTaskRef=NT_OSAP4_TerApp_E_Task12, OsAppTaskRef=NT_OSAP4_TerApp_E_Task13, OsAppTaskRef=NT_OSAP4_TerApp_E_Task14, OsAppTaskRef=NT_OSAP4_TerApp_E_Task15, OsAppTaskRef=NT_OSAP4_TerApp_E_Task16, OsAppTaskRef=NT_OSAP4_TerApp_E_Task17, OsAppTaskRef=NT_OSAP4_TerApp_E_Task18, OsRestartTask=NT_OSAP4_TerApp_E_ReTask3
        OsApplicationHooks: OsAppErrorHook=false, OsAppShutdownHook=false, OsAppStartupHook=false
      NT_OSAP4_TERAPP_F: OsTrusted=false, OsApplicationCoreAssignment=OS_CORE_ID_MASTER, OsAppTaskRef=NT_OSAP4_TerApp_F_Task1, OsAppTaskRef=NT_OSAP4_TerApp_F_ReTask2, OsAppTaskRef=NT_OSAP4_TerApp_F_Task3, OsAppTaskRef=NT_OSAP4_TerApp_F_Task4, OsAppTaskRef=NT_OSAP4_TerApp_F_Task5, OsAppTaskRef=NT_OSAP4_TerApp_F_Task6, OsAppTaskRef=NT_OSAP4_TerApp_F_Task7, OsAppTaskRef=NT_OSAP4_TerApp_F_Task8, OsAppTaskRef=NT_OSAP4_TerApp_F_Task9, OsAppTaskRef=NT_OSAP4_TerApp_F_Task10, OsAppTaskRef=NT_OSAP4_TerApp_F_Task11, OsAppTaskRef=NT_OSAP4_TerApp_F_Task12, OsAppTaskRef=NT_OSAP4_TerApp_F_Task13, OsAppTaskRef=NT_OSAP4_TerApp_F_Task14, OsAppTaskRef=NT_OSAP4_TerApp_F_Task15, OsAppTaskRef=NT_OSAP4_TerApp_F_Task16, OsAppTaskRef=NT_OSAP4_TerApp_F_Task17, OsRestartTask=NT_OSAP4_TerApp_F_ReTask2
        OsApplicationHooks: OsAppErrorHook=false, OsAppShutdownHook=false, OsAppStartupHook=false
      NT_OSAP1_S_TERAPP_MC: OsTrusted=false, OsApplicationCoreAssignment=OS_CORE_ID_SLAVE, OsAppTaskRef=NT_OSAP1_S_TerApp_MC_Task2, OsAppTaskRef=NT_OSAP1_S_TerApp_MC_ReTask3, OsRestartTask=NT_OSAP1_S_TerApp_MC_ReTask3
        OsApplicationHooks: OsAppErrorHook=false, OsAppShutdownHook=false, OsAppStartupHook=false
      NT_OSAP2_S_TERAPP_MC: OsTrusted=false, OsApplicationCoreAssignment=OS_CORE_ID_SLAVE, OsAppTaskRef=NT_OSAP2_S_TerApp_MC_Task2, OsAppTaskRef=NT_OSAP2_S_TerApp_MC_ReTask3, OsAppTaskRef=NT_OSAP2_S_TerApp_MC_Task4, OsAppTaskRef=NT_OSAP2_S_TerApp_MC_Task5, OsAppTaskRef=NT_OSAP2_S_TerApp_MC_Task6, OsRestartTask=NT_OSAP2_S_TerApp_MC_ReTask3
        OsApplicationHooks: OsAppErrorHook=false, OsAppShutdownHook=false, OsAppStartupHook=false
      NT_OSAP3_S_TERAPP_MC: OsTrusted=false, OsApplicationCoreAssignment=OS_CORE_ID_SLAVE, OsAppTaskRef=NT_OSAP3_S_TerApp_MC_Task2, OsAppTaskRef=NT_OSAP3_S_TerApp_MC_ReTask3, OsAppTaskRef=NT_OSAP3_S_TerApp_MC_Task4, OsAppTaskRef=NT_OSAP3_S_TerApp_MC_Task5, OsAppTaskRef=NT_OSAP3_S_TerApp_MC_Task6, OsAppTaskRef=NT_OSAP3_S_TerApp_MC_Task7, OsAppTaskRef=NT_OSAP3_S_TerApp_MC_Task8, OsAppTaskRef=NT_OSAP3_S_TerApp_MC_Task9, OsAppTaskRef=NT_OSAP3_S_TerApp_MC_Task10, OsRestartTask=NT_OSAP3_S_TerApp_MC_ReTask3
        OsApplicationHooks: OsAppErrorHook=false, OsAppShutdownHook=false, OsAppStartupHook=false
      NT_OSAP4_S_TERAPP_MC: OsTrusted=false, OsApplicationCoreAssignment=OS_CORE_ID_SLAVE, OsAppTaskRef=NT_OSAP4_S_TerApp_MC_Task2, OsAppTaskRef=NT_OSAP4_S_TerApp_MC_ReTask3, OsAppTaskRef=NT_OSAP4_S_TerApp_MC_Task4, OsAppTaskRef=NT_OSAP4_S_TerApp_MC_Task5, OsAppTaskRef=NT_OSAP4_S_TerApp_MC_Task6, OsAppTaskRef=NT_OSAP4_S_TerApp_MC_Task7, OsAppTaskRef=NT_OSAP4_S_TerApp_MC_Task8, OsAppTaskRef=NT_OSAP4_S_TerApp_MC_Task9, OsAppTaskRef=NT_OSAP4_S_TerApp_MC_Task10, OsAppTaskRef=NT_OSAP4_S_TerApp_MC_Task11, OsAppTaskRef=NT_OSAP4_S_TerApp_MC_Task12, OsAppTaskRef=NT_OSAP4_S_TerApp_MC_Task13, OsAppTaskRef=NT_OSAP4_S_TerApp_MC_Task14, OsAppTaskRef=NT_OSAP4_S_TerApp_MC_Task15, OsAppTaskRef=NT_OSAP4_S_TerApp_MC_Task16, OsAppTaskRef=NT_OSAP4_S_TerApp_MC_Task17, OsAppTaskRef=NT_OSAP4_S_TerApp_MC_Task18, OsRestartTask=NT_OSAP4_S_TerApp_MC_ReTask3
        OsApplicationHooks: OsAppErrorHook=false, OsAppShutdownHook=false, OsAppStartupHook=false
