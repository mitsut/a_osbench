AUTOSAR XML (schema 4-0-3)
package /Ecuc
  module config Os: ecuc-def-edition=4.2.0, implementation-config-variant=VARIANT-PRE-COMPILE
    OsInclude1 (OsInclude): OsIncludeFileName=perf_star_shut.h
    OsInclude2 (OsInclude): OsIncludeFileName=test_target_lib.h
    OsOS: OsNumberOfCores=2, OsStackMonitoring=false, OsUseGetServiceId=true, OsUseParameterAccess=true, OsScalabilityClass=SC1, OsStatus=EXTENDED
      OsHooks: OsErrorHook=true, OsPostTaskHook=false, OsPreTaskHook=false, OsProtectionHook=false, OsShutdownHook=false, OsStartupHook=false
    MainApp (OsAppMode)
    10 x OsTask, all with OsTaskActivation=1, OsTaskStackSize=TASK_STACK_SIZE, OsTaskSchedule=FULL:
      MainTask0: OsTaskPriority=1
        OsTaskAutostart: OsTaskAppModeRef=MainApp
      MainTask1: OsTaskPriority=1
        OsTaskAutostart: OsTaskAppModeRef=MainApp
      OSAP{1..4}_M_StartShut_Task{1..4}: OsTaskPriority=2
      OSAP{1..4}_S_StartShut_Task{1..4}: OsTaskPriority=2
    8 x OsApplication, all with OsTrusted=true:
      OSAP1_M: OsApplicationCoreAssignment=OS_CORE_ID_MASTER, OsAppTaskRef=MainTask0, OsAppTaskRef=OSAP1_M_StartShut_Task1
        OsApplicationHooks: OsAppErrorHook=false, OsAppShutdownHook=false, OsAppStartupHook=false
      OSAP2_M: OsApplicationCoreAssignment=OS_CORE_ID_MASTER, OsAppTaskRef=OSAP2_M_StartShut_Task2
        OsApplicationHooks: OsAppErrorHook=false, OsAppShutdownHook=false, OsAppStartupHook=false
      OSAP3_M: OsApplicationCoreAssignment=OS_CORE_ID_MASTER, OsAppTaskRef=OSAP3_M_StartShut_Task3
        OsApplicationHooks: OsAppErrorHook=false, OsAppShutdownHook=false, OsAppStartupHook=false
      OSAP4_M: OsApplicationCoreAssignment=OS_CORE_ID_MASTER, OsAppTaskRef=OSAP4_M_StartShut_Task4
        OsApplicationHooks: OsAppErrorHook=false, OsAppShutdownHook=false, OsAppStartupHook=false
      OSAP1_S: OsApplicationCoreAssignment=OS_CORE_ID_SLAVE, OsAppTaskRef=MainTask1, OsAppTaskRef=OSAP1_S_StartShut_Task1
        OsApplicationHooks: OsAppErrorHook=false, OsAppShutdownHook=false, OsAppStartupHook=false
      OSAP2_S: OsApplicationCoreAssignment=OS_CORE_ID_SLAVE, OsAppTaskRef=OSAP2_S_StartShut_Task2
        OsApplicationHooks: OsAppErrorHook=false, OsAppShutdownHook=false, OsAppStartupHook=false
      OSAP3_S: OsApplicationCoreAssignment=OS_CORE_ID_SLAVE, OsAppTaskRef=OSAP3_S_StartShut_Task3
        OsApplicationHooks: OsAppErrorHook=false, OsAppShutdownHook=false, OsAppStartupHook=false
      OSAP4_S: OsApplicationCoreAssignment=OS_CORE_ID_SLAVE, OsAppTaskRef=OSAP4_S_StartShut_Task4
        OsApplicationHooks: OsAppErrorHook=false, OsAppShutdownHook=false, OsAppStartupHook=false
