AUTOSAR XML (schema 4-0-3)
package /Ecuc
  module config Os: ecuc-def-edition=4.2.0, implementation-config-variant=VARIANT-PRE-COMPILE
    OsInclude1 (OsInclude): OsIncludeFileName=perf_star_shut.h
    OsInclude2 (OsInclude): OsIncludeFileName=test_target_lib.h
    OsOS: OsNumberOfCores=2, OsStackMonitoring=false, OsUseGetServiceId=true, OsUseParameterAccess=true, OsScalabilityClass=SC3, OsStatus=EXTENDED
      OsHooks: OsErrorHook=true, OsPostTaskHook=false, OsPreTaskHook=false, OsProtectionHook=true, OsShutdownHook=false, OsStartupHook=false
    MainApp (OsAppMode)
    34 x OsTask, all with OsTaskActivation=1, OsTaskStackSize=TASK_STACK_SIZE, OsTaskSchedule=FULL:
      MainTask0: OsTaskPriority=1
        OsTaskAutostart: OsTaskAppModeRef=MainApp
      MainTask1: OsTaskPriority=1
        OsTaskAutostart: OsTaskAppModeRef=MainApp
      OSAP{1..16}_M_StartShut_Task{1..16}: OsTaskPriority=2
      OSAP{1..16}_S_StartShut_Task{1..16}: OsTaskPriority=2
    32 x OsApplication, all with OsTrusted=true:
      OSAP1_M: OsApplicationCoreAssignment=OS_CORE_ID_MASTER, OsAppTaskRef=MainTask0, OsAppTaskRef=OSAP1_M_StartShut_Task1
        OsApplicationHooks: OsAppErrorHook=false, OsAppShutdownHook=false, OsAppStartupHook=false
      OSAP2_M: OsApplicationCoreAssignment=OS_CORE_ID_MASTER, OsAppTaskRef=OSAP2_M_StartShut_Task2
        OsApplicationHooks: OsAppErrorHook=false, OsAppShutdownHook=false, OsAppStartupHook=false
      OSAP3_M: OsApplicationCoreAssignment=OS_CORE_ID_MASTER, OsAppTaskRef=OSAP3_M_StartShut_Task3
        OsApplicationHooks: OsAppErrorHook=false, OsAppShutdownHook=false, OsAppStartupHook=false
      OSAP4_M: OsApplicationCoreAssignment=OS_CORE_ID_MASTER, OsAppTaskRef=OSAP4_M_StartShut_Task4
        OsApplicationHooks: OsAppErrorHook=false, OsAppShutdownHook=false, OsAppStartupHook=false
      OSAP5_M: OsApplicationCoreAssignment=OS_CORE_ID_MASTER, OsAppTaskRef=OSAP5_M_StartShut_Task5
        OsApplicationHooks: OsAppErrorHook=false, OsAppShutdownHook=false, OsAppStartupHook=false
      OSAP6_M: OsApplicationCoreAssignment=OS_CORE_ID_MASTER, OsAppTaskRef=OSAP6_M_StartShut_Task6
        OsApplicationHooks: OsAppErrorHook=false, OsAppShutdownHook=false, OsAppStartupHook=false
      OSAP7_M: OsApplicationCoreAssignment=OS_CORE_ID_MASTER, OsAppTaskRef=OSAP7_M_StartShut_Task7
        OsApplicationHooks: OsAppErrorHook=false, OsAppShutdownHook=false, OsAppStartupHook=false
      OSAP8_M: OsApplicationCoreAssignment=OS_CORE_ID_MASTER, OsAppTaskRef=OSAP8_M_StartShut_Task8
        OsApplicationHooks: OsAppErrorHook=false, OsAppShutdownHook=false, OsAppStartupHook=false
      OSAP9_M: OsApplicationCoreAssignment=OS_CORE_ID_MASTER, OsAppTaskRef=OSAP9_M_StartShut_Task9
        OsApplicationHooks: OsAppErrorHook=false, OsAppShutdownHook=false, OsAppStartupHook=false
      OSAP10_M: OsApplicationCoreAssignment=OS_CORE_ID_MASTER, OsAppTaskRef=OSAP10_M_StartShut_Task10
        OsApplicationHooks: OsAppErrorHook=false, OsAppShutdownHook=false, OsAppStartupHook=false
      OSAP11_M: OsApplicationCoreAssignment=OS_CORE_ID_MASTER, OsAppTaskRef=OSAP11_M_StartShut_Task11
        OsApplicationHooks: OsAppErrorHook=false, OsAppShutdownHook=false, OsAppStartupHook=false
      OSAP12_M: OsApplicationCoreAssignment=OS_CORE_ID_MASTER, OsAppTaskRef=OSAP12_M_StartShut_Task12
        OsApplicationHooks: OsAppErrorHook=false, OsAppShutdownHook=false, OsAppStartupHook=false
      OSAP13_M: OsApplicationCoreAssignment=OS_CORE_ID_MASTER, OsAppTaskRef=OSAP13_M_StartShut_Task13
        OsApplicationHooks: OsAppErrorHook=false, OsAppShutdownHook=false, OsAppStartupHook=false
      OSAP14_M: OsApplicationCoreAssignment=OS_CORE_ID_MASTER, OsAppTaskRef=OSAP14_M_StartShut_Task14
        OsApplicationHooks: OsAppErrorHook=false, OsAppShutdownHook=false, OsAppStartupHook=false
      OSAP15_M: OsApplicationCoreAssignment=OS_CORE_ID_MASTER, OsAppTaskRef=OSAP15_M_StartShut_Task15
        OsApplicationHooks: OsAppErrorHook=false, OsAppShutdownHook=false, OsAppStartupHook=false
      OSAP16_M: OsApplicationCoreAssignment=OS_CORE_ID_MASTER, OsAppTaskRef=OSAP16_M_StartShut_Task16
        OsApplicationHooks: OsAppErrorHook=false, OsAppShutdownHook=false, OsAppStartupHook=false
      OSAP1_S: OsApplicationCoreAssignment=OS_CORE_ID_SLAVE, OsAppTaskRef=MainTask1, OsAppTaskRef=OSAP1_S_StartShut_Task1
        OsApplicationHooks: OsAppErrorHook=false, OsAppShutdownHook=false, OsAppStartupHook=false
      OSAP2_S: OsApplicationCoreAssignment=OS_CORE_ID_SLAVE, OsAppTaskRef=OSAP2_S_StartShut_Task2
        OsApplicationHooks: OsAppErrorHook=false, OsAppShutdownHook=false, OsAppStartupHook=false
      OSAP3_S: OsApplicationCoreAssignment=OS_CORE_ID_SLAVE, OsAppTaskRef=OSAP3_S_StartShut_Task3
        OsApplicationHooks: OsAppErrorHook=false, OsAppShutdownHook=false, OsAppStartupHook=false
      OSAP4_S: OsApplicationCoreAssignment=OS_CORE_ID_SLAVE, OsAppTaskRef=OSAP4_S_StartShut_Task4
        OsApplicationHooks: OsAppErrorHook=false, OsAppShutdownHook=false, OsAppStartupHook=false
      OSAP5_S: OsApplicationCoreAssignment=OS_CORE_ID_SLAVE, OsAppTaskRef=OSAP5_S_StartShut_Task5
        OsApplicationHooks: OsAppErrorHook=false, OsAppShutdownHook=false, OsAppStartupHook=false
      OSAP6_S: OsApplicationCoreAssignment=OS_CORE_ID_SLAVE, OsAppTaskRef=OSAP6_S_StartShut_Task6
        OsApplicationHooks: OsAppErrorHook=false, OsAppShutdownHook=false, OsAppStartupHook=false
      OSAP7_S: OsApplicationCoreAssignment=OS_CORE_ID_SLAVE, OsAppTaskRef=OSAP7_S_StartShut_Task7
        OsApplicationHooks: OsAppErrorHook=false, OsAppShutdownHook=false, OsAppStartupHook=false
      OSAP8_S: OsApplicationCoreAssignment=OS_CORE_ID_SLAVE, OsAppTaskRef=OSAP8_S_StartShut_Task8
        OsApplicationHooks: OsAppErrorHook=false, OsAppShutdownHook=false, OsAppStartupHook=false
      OSAP9_S: OsApplicationCoreAssignment=OS_CORE_ID_SLAVE, OsAppTaskRef=OSAP9_S_StartShut_Task9
        OsApplicationHooks: OsAppErrorHook=false, OsAppShutdownHook=false, OsAppStartupHook=false
      OSAP10_S: OsApplicationCoreAssignment=OS_CORE_ID_SLAVE, OsAppTaskRef=OSAP10_S_StartShut_Task10
        OsApplicationHooks: OsAppErrorHook=false, OsAppShutdownHook=false, OsAppStartupHook=false
      OSAP11_S: OsApplicationCoreAssignment=OS_CORE_ID_SLAVE, OsAppTaskRef=OSAP11_S_StartShut_Task11
        OsApplicationHooks: OsAppErrorHook=false, OsAppShutdownHook=false, OsAppStartupHook=false
      OSAP12_S: OsApplicationCoreAssignment=OS_CORE_ID_SLAVE, OsAppTaskRef=OSAP12_S_StartShut_Task12
        OsApplicationHooks: OsAppErrorHook=false, OsAppShutdownHook=false, OsAppStartupHook=false
      OSAP13_S: OsApplicationCoreAssignment=OS_CORE_ID_SLAVE, OsAppTaskRef=OSAP13_S_StartShut_Task13
        OsApplicationHooks: OsAppErrorHook=false, OsAppShutdownHook=false, OsAppStartupHook=false
      OSAP14_S: OsApplicationCoreAssignment=OS_CORE_ID_SLAVE, OsAppTaskRef=OSAP14_S_StartShut_Task14
        OsApplicationHooks: OsAppErrorHook=false, OsAppShutdownHook=false, OsAppStartupHook=false
      OSAP15_S: OsApplicationCoreAssignment=OS_CORE_ID_SLAVE, OsAppTaskRef=OSAP15_S_StartShut_Task15
        OsApplicationHooks: OsAppErrorHook=false, OsAppShutdownHook=false, OsAppStartupHook=false
      OSAP16_S: OsApplicationCoreAssignment=OS_CORE_ID_SLAVE, OsAppTaskRef=OSAP16_S_StartShut_Task16
        OsApplicationHooks: OsAppErrorHook=false, OsAppShutdownHook=false, OsAppStartupHook=false
