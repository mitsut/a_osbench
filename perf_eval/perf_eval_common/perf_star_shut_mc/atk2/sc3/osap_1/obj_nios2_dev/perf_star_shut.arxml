AUTOSAR XML (schema 4-0-3)
package /Ecuc
  module config Os: ecuc-def-edition=4.2.0, implementation-config-variant=VARIANT-PRE-COMPILE
    OsInclude1 (OsInclude): OsIncludeFileName=perf_star_shut.h
    OsInclude2 (OsInclude): OsIncludeFileName=test_target_lib.h
    OsOS: OsNumberOfCores=2, OsStackMonitoring=false, OsUseGetServiceId=true, OsUseParameterAccess=true, OsScalabilityClass=SC3, OsStatus=EXTENDED
      OsHooks: OsErrorHook=true, OsPostTaskHook=false, OsPreTaskHook=false, OsProtectionHook=true, OsShutdownHook=false, OsStartupHook=false
    MainApp (OsAppMode)
    4 x OsTask, all with OsTaskActivation=1, OsTaskStackSize=TASK_STACK_SIZE, OsTaskSchedule=FULL:
      MainTask0: OsTaskPriority=1
        OsTaskAutostart: OsTaskAppModeRef=MainApp
      MainTask1: OsTaskPriority=1
        OsTaskAutostart: OsTaskAppModeRef=MainApp
      OSAP1_M_StartShut_Task1: OsTaskPriority=2
      OSAP1_S_StartShut_Task1: OsTaskPriority=2
    T_OSAP1_M (OsApplication): OsTrusted=true, OsApplicationCoreAssignment=OS_CORE_ID_MASTER, OsAppTaskRef=MainTask0, OsAppTaskRef=OSAP1_M_StartShut_Task1
      OsApplicationHooks: OsAppErrorHook=false, OsAppShutdownHook=false, OsAppStartupHook=false
    T_OSAP1_S (OsApplication): OsTrusted=true, OsApplicationCoreAssignment=OS_CORE_ID_SLAVE, OsAppTaskRef=MainTask1, OsAppTaskRef=OSAP1_S_StartShut_Task1
      OsApplicationHooks: OsAppErrorHook=false, OsAppShutdownHook=false, OsAppStartupHook=false
