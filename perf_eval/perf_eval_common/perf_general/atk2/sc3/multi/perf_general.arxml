AUTOSAR XML (schema 4-0-3)
standard types defined: uint8
package /Ecuc
  module config Os: ecuc-def-edition=4.2.0, implementation-config-variant=VARIANT-PRE-COMPILE
    3 x OsInclude:
      OsInclude1: OsIncludeFileName=perf_general.h
      OsInclude2: OsIncludeFileName=test_target_lib.h
      OsInclude3: OsIncludeFileName=perf_general_nt.h
    OsOS: OsNumberOfCores=2, OsStackMonitoring=false, OsUseGetServiceId=true, OsUseParameterAccess=true, OsScalabilityClass=SC3, OsStatus=EXTENDED
      OsHooks: OsErrorHook=true, OsPostTaskHook=false, OsPreTaskHook=false, OsProtectionHook=true, OsShutdownHook=false, OsStartupHook=false
    MainApp (OsAppMode)
    8 x OsEvent:
      Event_T2Evt: OsEventMask=EVENT_T2_MASK
      Event_T2SetEvt: OsEventMask=SETEVENT_T2_MASK
      Event_T3Evt: OsEventMask=EVENT_T3_MASK
      Event_MC_T3Evt: OsEventMask=EVENT_MC_T3_MASK
      NT_Event_T2Evt: OsEventMask=NT_EVENT_T2_MASK
      NT_Event_T2SetEvt: OsEventMask=NT_SETEVENT_T2_MASK
      NT_Event_T3Evt: OsEventMask=NT_EVENT_T3_MASK
      NT_Event_MC_T3Evt: OsEventMask=NT_EVENT_MC_T3_MASK
    4 x OsResource, all with OsResourceProperty=STANDARD:
      TskLevelRes
      IsrLevelRes
      NT_TskLevelRes: OsResourceAccessingApplication=NT_OSAP1
      NT_IsrLevelRes: OsResourceAccessingApplication=NT_OSAP1
    4 x OsSpinlock, all with OsSpinlockLockMethod=LOCK_NOTHING:
      Spin_MC_Spinlock1: OsSpinlockAccessingApplication=T_OSAP1_M, OsSpinlockAccessingApplication=T_OSAP2_S
      Int_MC_Spinlock1: OsSpinlockAccessingApplication=T_OSAP1_M, OsSpinlockAccessingApplication=T_OSAP2_S
      Spin_MC_Spinlock2: OsSpinlockAccessingApplication=NT_OSAP1, OsSpinlockAccessingApplication=NT_OSAP2_S
      Int_MC_Spinlock2: OsSpinlockAccessingApplication=NT_OSAP1, OsSpinlockAccessingApplication=NT_OSAP2_S
    8 x OsIsr, all with OsIsrCategory=CATEGORY_2, OsIsrInterruptSource=ENABLE, OsIsrInterruptPriority=INTPRI_TIMER_NUM, OsIsrStackSize=ISR_STACK_SIZE:
      Act_Isr2: OsIsrInterruptNumber=INTNO_ACTISR2_1
      Resource_Isr2: OsIsrInterruptNumber=INTNO_RESOURCE, OsIsrResourceRef=IsrLevelRes, OsIsrResourceRef=NT_IsrLevelRes
      SetE_Isr2: OsIsrInterruptNumber=INTNO_SET_EVENT_1, OsIsrResourceRef=TskLevelRes, OsIsrResourceRef=IsrLevelRes
      Int_A_Isr2: OsIsrInterruptNumber=INTNO_INT_A_TIMER
      Int_B_Isr2: OsIsrInterruptNumber=INTNO_INT_B_TIMER
      OSAP1_M_Int_MC_Isr2: OsIsrInterruptNumber=INTNO_INT_MC_TIMER
      T_OSAP2_Act_Isr2: OsIsrInterruptNumber=INTNO_ACTISR2_2
      T_OSAP2_SetE_Isr2: OsIsrInterruptNumber=INTNO_SET_EVENT_2
    IOC (OsIoc)
      8 x OsIocCommunication:
        IOC_QUEUE_OSAP1: OsIocBufferLength=1
          IOC_QUEUE_OSAP1_DATA (OsIocDataProperties): OsIocDataPropertyIndex=0, OsIocInitValue=10U, OsIocDataTypeRef=uint8
          IOC_QUEUE_OSAP1_RCV (OsIocReceiverProperties): OsIocFunctionImplementationKind=FUNCTION, OsIocReceivingOsApplicationRef=T_OSAP2
          IOC_QUEUE_OSAP1_SND (OsIocSenderProperties): OsIocFunctionImplementationKind=FUNCTION, OsIocSendingOsApplicationRef=T_OSAP1
        IOC_DEQUEUE_OSAP1
          IOC_DEQUEUE_OSAP1_DATA (OsIocDataProperties): OsIocDataPropertyIndex=0, OsIocInitValue=10U, OsIocDataTypeRef=uint8
          IOC_DEQUEUE_OSAP1_RCV (OsIocReceiverProperties): OsIocFunctionImplementationKind=FUNCTION, OsIocReceivingOsApplicationRef=T_OSAP2
          IOC_DEQUEUE_OSAP1_SND (OsIocSenderProperties): OsIocFunctionImplementationKind=FUNCTION, OsIocSendingOsApplicationRef=T_OSAP1
        IOC_QUEUE_NTOSAP1: OsIocBufferLength=1
          IOC_QUEUE_NTOSAP1_DATA (OsIocDataProperties): OsIocDataPropertyIndex=0, OsIocInitValue=10U, OsIocDataTypeRef=uint8
          IOC_QUEUE_NTOSAP1_RCV (OsIocReceiverProperties): OsIocFunctionImplementationKind=FUNCTION, OsIocReceivingOsApplicationRef=NT_OSAP2
          IOC_QUEUE_NTOSAP1_SND (OsIocSenderProperties): OsIocFunctionImplementationKind=FUNCTION, OsIocSendingOsApplicationRef=NT_OSAP1
        IOC_DEQUEUE_NTOSAP1
          IOC_DEQUEUE_NTOSAP1_DATA (OsIocDataProperties): OsIocDataPropertyIndex=0, OsIocInitValue=10U, OsIocDataTypeRef=uint8
          IOC_DEQUEUE_NTOSAP1_RCV (OsIocReceiverProperties): OsIocFunctionImplementationKind=FUNCTION, OsIocReceivingOsApplicationRef=NT_OSAP2
          IOC_DEQUEUE_NTOSAP1_SND (OsIocSenderProperties): OsIocFunctionImplementationKind=FUNCTION, OsIocSendingOsApplicationRef=NT_OSAP1
        IOC_QUEUE_OSAP1_M: OsIocBufferLength=1
          IOC_QUEUE_OSAP1_M_DATA (OsIocDataProperties): OsIocDataPropertyIndex=0, OsIocInitValue=10U, OsIocDataTypeRef=uint8
          IOC_QUEUE_OSAP1_M_RCV (OsIocReceiverProperties): OsIocFunctionImplementationKind=FUNCTION, OsIocReceivingOsApplicationRef=T_OSAP2_S
          IOC_QUEUE_OSAP1_M_SND (OsIocSenderProperties): OsIocFunctionImplementationKind=FUNCTION, OsIocSendingOsApplicationRef=T_OSAP1_M
        IOC_DEQUEUE_OSAP1_M
          IOC_DEQUEUE_OSAP1_M_DATA (OsIocDataProperties): OsIocDataPropertyIndex=0, OsIocInitValue=10U, OsIocDataTypeRef=uint8
          IOC_DEQUEUE_OSAP1_M_RCV (OsIocReceiverProperties): OsIocFunctionImplementationKind=FUNCTION, OsIocReceivingOsApplicationRef=T_OSAP2_S
          IOC_DEQUEUE_OSAP1_M_SND (OsIocSenderProperties): OsIocFunctionImplementationKind=FUNCTION, OsIocSendingOsApplicationRef=T_OSAP1_M
        IOC_QUEUE_NTOSAP1_M: OsIocBufferLength=1
          IOC_QUEUE_NTOSAP1_M_DATA (OsIocDataProperties): OsIocDataPropertyIndex=0, OsIocInitValue=10U, OsIocDataTypeRef=uint8
          IOC_QUEUE_NTOSAP1_M_RCV (OsIocReceiverProperties): OsIocFunctionImplementationKind=FUNCTION, OsIocReceivingOsApplicationRef=NT_OSAP2_S
          IOC_QUEUE_NTOSAP1_M_SND (OsIocSenderProperties): OsIocFunctionImplementationKind=FUNCTION, OsIocSendingOsApplicationRef=NT_OSAP1
        IOC_DEQUEUE_NTOSAP1_M
          IOC_DEQUEUE_NTOSAP1_M_DATA (OsIocDataProperties): OsIocDataPropertyIndex=0, OsIocInitValue=10U, OsIocDataTypeRef=uint8
          IOC_DEQUEUE_NTOSAP1_M_RCV (OsIocReceiverProperties): OsIocFunctionImplementationKind=FUNCTION, OsIocReceivingOsApplicationRef=NT_OSAP2_S
          IOC_DEQUEUE_NTOSAP1_M_SND (OsIocSenderProperties): OsIocFunctionImplementationKind=FUNCTION, OsIocSendingOsApplicationRef=NT_OSAP1
    89 x OsTask, all with OsTaskActivation=1, OsTaskStackSize=TASK_STACK_SIZE, OsTaskSchedule=FULL:
      MainTask: OsTaskPriority=1
        OsTaskAutostart: OsTaskAppModeRef=MainApp
      Act_Task1: OsTaskPriority=2
      Act_Task2: OsTaskPriority=3
      Act_Task3: OsTaskPriority=4
      Act_Task4: OsTaskPriority=5
      Ter_Task1: OsTaskPriority=2
      Ter_Task2: OsTaskPriority=3
      Chain_Task1: OsTaskPriority=2
      Chain_Task2: OsTaskPriority=3
      Interrupt_Task1: OsTaskPriority=2
      Resource_Task1: OsTaskPriority=2, OsTaskResourceRef=TskLevelRes, OsTaskResourceRef=IsrLevelRes
      Resource_Task2: OsTaskPriority=3, OsTaskResourceRef=TskLevelRes
      Event_Task1: OsTaskPriority=2
      Event_Task2: OsTaskPriority=3, OsTaskEventRef=Event_T2Evt
      SetE_Task1: OsTaskPriority=2
      SetE_Task2: OsTaskPriority=3, OsTaskEventRef=Event_T2SetEvt
      SetE_Task3: OsTaskPriority=4, OsTaskEventRef=Event_T3Evt
      Int_A_Task1: OsTaskPriority=2
      Int_B_Task1: OsTaskPriority=2
      Int_B_Task2: OsTaskPriority=3
      PrintTask: OsTaskPriority=2
      OSAP1_IOC_Task1: OsTaskPriority=2
      NT_OSAP1_Act_Task1_ntnt: OsTaskPriority=2
      NT_OSAP1_Act_Task2: OsTaskPriority=3
      NT_OSAP1_Act_Task3_ntnt: OsTaskPriority=4
      NT_OSAP1_Act_Task1_tnt: OsTaskPriority=2
      NT_OSAP1_Act_Task3_tnt1: OsTaskPriority=4
      NT_OSAP1_Act_Task3_tnt2: OsTaskPriority=4
      NT_OSAP1_Act_Task4: OsTaskPriority=5
      NT_OSAP1_Act_ResetTask: OsTaskPriority=5
      NT_OSAP1_Ter_ResetTask: OsTaskPriority=4
      NT_OSAP1_Ter_Task1: OsTaskPriority=2
      NT_OSAP1_Ter_Task2: OsTaskPriority=3
      NT_OSAP1_Chain_Task1: OsTaskPriority=2
      NT_OSAP1_Chain_Task2: OsTaskPriority=3
      NT_OSAP1_Chain_ResetTask: OsTaskPriority=4
      NT_OSAP1_Resource_Task1: OsTaskPriority=2, OsTaskResourceRef=NT_TskLevelRes, OsTaskResourceRef=NT_IsrLevelRes
      NT_OSAP1_Resource_Task2: OsTaskPriority=3, OsTaskResourceRef=NT_TskLevelRes
      NT_OSAP1_Event_Task1: OsTaskPriority=2
      NT_OSAP1_Event_Task2: OsTaskPriority=3, OsTaskEventRef=NT_Event_T2Evt
      NT_OSAP1_SetE_Task1: OsTaskPriority=2
      NT_OSAP1_SetE_Task2: OsTaskPriority=3, OsTaskEventRef=NT_Event_T2SetEvt
      NT_OSAP1_SetE_Task3: OsTaskPriority=4, OsTaskEventRef=NT_Event_T3Evt
      NT_OSAP1_Int_A_Task1: OsTaskPriority=2
      NT_OSAP1_Int_B_Task1: OsTaskPriority=2
      NT_OSAP1_IOC_Task1: OsTaskPriority=2, OsTaskAccessingApplication=NT_OSAP2
      OSAP1_M_Act_Task1: OsTaskPriority=2
      OSAP1_M_SetE_Task1: OsTaskPriority=2
      OSAP1_M_Spin_Task1: OsTaskPriority=2
      OSAP1_M_Int_MC_Task1: OsTaskPriority=2
      OSAP1_M_IOC_Task1: OsTaskPriority=2
      NT_OSAP1_M_Act_Task1: OsTaskPriority=2, OsTaskAccessingApplication=NT_OSAP2_S
      NT_OSAP1_M_SetE_Task1: OsTaskPriority=2, OsTaskAccessingApplication=NT_OSAP2_S
      NT_OSAP1_M_Int_MC_Task1: OsTaskPriority=2
      NT_OSAP1_M_Spin_Task1: OsTaskPriority=2
      NT_OSAP1_M_IOC_Task1: OsTaskPriority=2
      T_OSAP2_Act_Task2_tnt1: OsTaskPriority=3
      T_OSAP2_Act_Task2_tnt2: OsTaskPriority=3
      T_OSAP2_Ter_Task2_1: OsTaskPriority=3
      T_OSAP2_Ter_Task2_2: OsTaskPriority=3
      T_OSAP2_Chain_Task1_1: OsTaskPriority=2
      T_OSAP2_Chain_Task1_2: OsTaskPriority=2
      OSAP2_IOC_Task2: OsTaskPriority=3
      NT_OSAP2_Act_ResetTask: OsTaskPriority=5, OsTaskAccessingApplication=NT_OSAP1
      NT_OSAP2_Act_Task1: OsTaskPriority=2, OsTaskAccessingApplication=NT_OSAP3
      NT_OSAP2_Act_Task3: OsTaskPriority=4, OsTaskAccessingApplication=NT_OSAP3
      NT_OSAP2_Ter_Task2: OsTaskPriority=3
      NT_OSAP2_Ter_ResetTask: OsTaskPriority=4
      NT_OSAP2_Chain_ResetTask: OsTaskPriority=4
      NT_OSAP2_Chain_Task1: OsTaskPriority=2
      NT_OSAP2_Int_B_Task2: OsTaskPriority=3
      NT_OSAP2_IOC_Task2: OsTaskPriority=3, OsTaskAccessingApplication=NT_OSAP1
      OSAP2_S_Act_Task2: OsTaskPriority=3
      OSAP2_S_Act_Task3: OsTaskPriority=4
      OSAP2_S_SetE_Task2: OsTaskPriority=3
      OSAP2_S_SetE_Task3: OsTaskPriority=4, OsTaskEventRef=Event_MC_T3Evt
      OSAP2_S_Int_MC_Task2: OsTaskPriority=3
      OSAP2_S_IOC_Task2: OsTaskPriority=3
      NT_OSAP2_S_Act_Task2: OsTaskPriority=3, OsTaskAccessingApplication=NT_OSAP1
      NT_OSAP2_S_Act_Task3: OsTaskPriority=4, OsTaskAccessingApplication=NT_OSAP1
      NT_OSAP2_S_Act_ResetTask: OsTaskPriority=5, OsTaskAccessingApplication=NT_OSAP1
      NT_OSAP2_S_SetE_Task2: OsTaskPriority=3, OsTaskAccessingApplication=NT_OSAP1
      NT_OSAP2_S_SetE_Task3: OsTaskPriority=4, OsTaskAccessingApplication=NT_OSAP1, OsTaskEventRef=NT_Event_MC_T3Evt
      NT_OSAP2_S_Int_MC_Task2: OsTaskPriority=3, OsTaskAccessingApplication=NT_OSAP1
      NT_OSAP2_S_IOC_Task2: OsTaskPriority=3, OsTaskAccessingApplication=NT_OSAP1
      NT_OSAP3_Act_Task2: OsTaskPriority=3, OsTaskAccessingApplication=NT_OSAP2
      NT_OSAP3_Chain_Task2: OsTaskPriority=3, OsTaskAccessingApplication=NT_OSAP2
      NT_OSAP3_Ter_Task1: OsTaskPriority=2, OsTaskAccessingApplication=NT_OSAP2
      S_IdleTask: OsTaskPriority=1
    10 x OsApplication:
      T_OSAP_MAIN: OsTrusted=true, OsApplicationCoreAssignment=OS_CORE_ID_MASTER, OsAppTaskRef=MainTask
        OsApplicationHooks: OsAppErrorHook=false, OsAppShutdownHook=false, OsAppStartupHook=false
      T_OSAP1: OsTrusted=true, OsApplicationCoreAssignment=OS_CORE_ID_MASTER, OsAppTaskRef=Act_Task1, OsAppTaskRef=Act_Task2, OsAppTaskRef=Act_Task3, OsAppTaskRef=Act_Task4, OsAppTaskRef=Ter_Task1, OsAppTaskRef=Ter_Task2, OsAppTaskRef=Chain_Task1, OsAppTaskRef=Chain_Task2, OsAppTaskRef=Interrupt_Task1, OsAppTaskRef=Resource_Task1, OsAppTaskRef=Resource_Task2, OsAppTaskRef=Event_Task1, OsAppTaskRef=Event_Task2, OsAppTaskRef=SetE_Task1, OsAppTaskRef=SetE_Task2, OsAppTaskRef=SetE_Task3, OsAppTaskRef=Int_A_Task1, OsAppTaskRef=Int_B_Task1, OsAppTaskRef=Int_B_Task2, OsAppTaskRef=PrintTask, OsAppTaskRef=OSAP1_IOC_Task1, OsAppIsrRef=Act_Isr2, OsAppIsrRef=Resource_Isr2, OsAppIsrRef=SetE_Isr2, OsAppIsrRef=Int_A_Isr2, OsAppIsrRef=Int_B_Isr2
        OsApplicationHooks: OsAppErrorHook=false, OsAppShutdownHook=false, OsAppStartupHook=false
        11 x OsApplicationTrustedFunction:
          TRIGGER_RES_ISR2_TFN1: OsTrustedFunctionName=TRUSTED_res_isr2_tfn1
          INIT_TIMER_INT_A_TFN1: OsTrustedFunctionName=TRUSTED_isr2_a_tfn1
          TERMINATE_TIMER_INT_A_TFN1: OsTrustedFunctionName=TRUSTED_isr2_a_tfn2
          INIT_TIMER_INT_B_TFN1: OsTrustedFunctionName=TRUSTED_isr2_b_tfn1
          TERMINATE_TIMER_INT_B_TFN1: OsTrustedFunctionName=TRUSTED_isr2_b_tfn2
          SETEVENT_MC_TFN{1..3}: OsTrustedFunctionName=TRUSTED_setevent_mc_tfn{1..3}
          ISR2_MC_TFN{1..3}: OsTrustedFunctionName=TRUSTED_isr2_mc_tfn{1..3}
      T_OSAP1_M: OsTrusted=true, OsApplicationCoreAssignment=OS_CORE_ID_MASTER, OsAppTaskRef=OSAP1_M_Act_Task1, OsAppTaskRef=OSAP1_M_SetE_Task1, OsAppTaskRef=OSAP1_M_Spin_Task1, OsAppTaskRef=OSAP1_M_Int_MC_Task1, OsAppTaskRef=OSAP1_M_IOC_Task1, OsAppIsrRef=OSAP1_M_Int_MC_Isr2
        OsApplicationHooks: OsAppErrorHook=false, OsAppShutdownHook=false, OsAppStartupHook=false
      T_OSAP1_S: OsTrusted=true, OsApplicationCoreAssignment=OS_CORE_ID_SLAVE, OsAppTaskRef=S_IdleTask
        OsApplicationHooks: OsAppErrorHook=false, OsAppShutdownHook=false, OsAppStartupHook=false
      NT_OSAP1: OsTrusted=false, OsApplicationCoreAssignment=OS_CORE_ID_MASTER, OsAppTaskRef=NT_OSAP1_Act_Task1_ntnt, OsAppTaskRef=NT_OSAP1_Act_Task2, OsAppTaskRef=NT_OSAP1_Act_Task3_ntnt, OsAppTaskRef=NT_OSAP1_Act_Task1_tnt, OsAppTaskRef=NT_OSAP1_Act_Task3_tnt1, OsAppTaskRef=NT_OSAP1_Act_Task3_tnt2, OsAppTaskRef=NT_OSAP1_Act_Task4, OsAppTaskRef=NT_OSAP1_Act_ResetTask, OsAppTaskRef=NT_OSAP1_Ter_ResetTask, OsAppTaskRef=NT_OSAP1_Ter_Task1, OsAppTaskRef=NT_OSAP1_Ter_Task2, OsAppTaskRef=NT_OSAP1_Chain_Task1, OsAppTaskRef=NT_OSAP1_Chain_Task2, OsAppTaskRef=NT_OSAP1_Chain_ResetTask, OsAppTaskRef=NT_OSAP1_Resource_Task1, OsAppTaskRef=NT_OSAP1_Resource_Task2, OsAppTaskRef=NT_OSAP1_Event_Task1, OsAppTaskRef=NT_OSAP1_Event_Task2, OsAppTaskRef=NT_OSAP1_SetE_Task1, OsAppTaskRef=NT_OSAP1_SetE_Task2, OsAppTaskRef=NT_OSAP1_SetE_Task3, OsAppTaskRef=NT_OSAP1_Int_A_Task1, OsAppTaskRef=NT_OSAP1_Int_B_Task1, OsAppTaskRef=NT_OSAP1_IOC_Task1, OsAppTaskRef=NT_OSAP1_M_Act_Task1, OsAppTaskRef=NT_OSAP1_M_SetE_Task1, OsAppTaskRef=NT_OSAP1_M_Int_MC_Task1, OsAppTaskRef=NT_OSAP1_M_Spin_Task1, OsAppTaskRef=NT_OSAP1_M_IOC_Task1
        OsApplicationHooks: OsAppErrorHook=false, OsAppShutdownHook=false, OsAppStartupHook=false
      T_OSAP2: OsTrusted=true, OsApplicationCoreAssignment=OS_CORE_ID_MASTER, OsAppTaskRef=T_OSAP2_Act_Task2_tnt1, OsAppTaskRef=T_OSAP2_Act_Task2_tnt2, OsAppTaskRef=T_OSAP2_Ter_Task2_1, OsAppTaskRef=T_OSAP2_Ter_Task2_2, OsAppTaskRef=T_OSAP2_Chain_Task1_1, OsAppTaskRef=T_OSAP2_Chain_Task1_2, OsAppTaskRef=OSAP2_IOC_Task2, OsAppIsrRef=T_OSAP2_Act_Isr2, OsAppIsrRef=T_OSAP2_SetE_Isr2
        OsApplicationHooks: OsAppErrorHook=false, OsAppShutdownHook=false, OsAppStartupHook=false
        TRIGGER_ACT_ISR2_TFN1 (OsApplicationTrustedFunction): OsTrustedFunctionName=TRUSTED_act_isr2_tfn1
        TRIGGER_SETEVENT_ISR2_TFN1 (OsApplicationTrustedFunction): OsTrustedFunctionName=TRUSTED_setevent_isr2_tfn1
      NT_OSAP2: OsTrusted=false, OsApplicationCoreAssignment=OS_CORE_ID_MASTER, OsAppTaskRef=NT_OSAP2_Act_ResetTask, OsAppTaskRef=NT_OSAP2_Act_Task1, OsAppTaskRef=NT_OSAP2_Act_Task3, OsAppTaskRef=NT_OSAP2_Ter_Task2, OsAppTaskRef=NT_OSAP2_Ter_ResetTask, OsAppTaskRef=NT_OSAP2_Chain_ResetTask, OsAppTaskRef=NT_OSAP2_Chain_Task1, OsAppTaskRef=NT_OSAP2_Int_B_Task2, OsAppTaskRef=NT_OSAP2_IOC_Task2
        OsApplicationHooks: OsAppErrorHook=false, OsAppShutdownHook=false, OsAppStartupHook=false
      NT_OSAP3: OsTrusted=false, OsApplicationCoreAssignment=OS_CORE_ID_MASTER, OsAppTaskRef=NT_OSAP3_Act_Task2, OsAppTaskRef=NT_OSAP3_Chain_Task2, OsAppTaskRef=NT_OSAP3_Ter_Task1
        OsApplicationHooks: OsAppErrorHook=false, OsAppShutdownHook=false, OsAppStartupHook=false
      T_OSAP2_S: OsTrusted=true, OsApplicationCoreAssignment=OS_CORE_ID_SLAVE, OsAppTaskRef=OSAP2_S_Act_Task2, OsAppTaskRef=OSAP2_S_Act_Task3, OsAppTaskRef=OSAP2_S_SetE_Task2, OsAppTaskRef=OSAP2_S_SetE_Task3, OsAppTaskRef=OSAP2_S_Int_MC_Task2, OsAppTaskRef=OSAP2_S_IOC_Task2
        OsApplicationHooks: OsAppErrorHook=false, OsAppShutdownHook=false, OsAppStartupHook=false
      NT_OSAP2_S: OsTrusted=false, OsApplicationCoreAssignment=OS_CORE_ID_SLAVE, OsAppTaskRef=NT_OSAP2_S_Act_Task2, OsAppTaskRef=NT_OSAP2_S_Act_Task3, OsAppTaskRef=NT_OSAP2_S_Act_ResetTask, OsAppTaskRef=NT_OSAP2_S_SetE_Task2, OsAppTaskRef=NT_OSAP2_S_SetE_Task3, OsAppTaskRef=NT_OSAP2_S_Int_MC_Task2, OsAppTaskRef=NT_OSAP2_S_IOC_Task2
        OsApplicationHooks: OsAppErrorHook=false, OsAppShutdownHook=false, OsAppStartupHook=false
