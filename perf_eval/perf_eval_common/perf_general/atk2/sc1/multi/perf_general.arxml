AUTOSAR XML (schema 4-0-3)
standard types defined: uint8
package /Ecuc
  module config Os: ecuc-def-edition=4.2.0, implementation-config-variant=VARIANT-PRE-COMPILE
    OsInclude1 (OsInclude): OsIncludeFileName=perf_general.h
    OsInclude2 (OsInclude): OsIncludeFileName=test_target_lib.h
    OsOS: OsNumberOfCores=2, OsStackMonitoring=false, OsUseGetServiceId=true, OsUseParameterAccess=true, OsScalabilityClass=SC1, OsStatus=EXTENDED
      OsHooks: OsErrorHook=true, OsPostTaskHook=false, OsPreTaskHook=false, OsProtectionHook=true, OsShutdownHook=false, OsStartupHook=false
    MainApp (OsAppMode)
    4 x OsEvent:
      Event_T2Evt: OsEventMask=EVENT_T2_MASK
      Event_T2SetEvt: OsEventMask=SETEVENT_T2_MASK
      Event_T3Evt: OsEventMask=EVENT_T3_MASK
      Event_MC_T3Evt: OsEventMask=EVENT_MC_T3_MASK
    TskLevelRes (OsResource): OsResourceProperty=STANDARD
    IsrLevelRes (OsResource): OsResourceProperty=STANDARD
    Spin_MC_Spinlock1 (OsSpinlock): OsSpinlockLockMethod=LOCK_NOTHING, OsSpinlockAccessingApplication=OSAP1_M, OsSpinlockAccessingApplication=OSAP2_S
    Int_MC_Spinlock1 (OsSpinlock): OsSpinlockLockMethod=LOCK_NOTHING, OsSpinlockAccessingApplication=OSAP1_M, OsSpinlockAccessingApplication=OSAP2_S
    6 x OsIsr, all with OsIsrCategory=CATEGORY_2, OsIsrInterruptPriority=INTPRI_TIMER_NUM, OsIsrStackSize=ISR_STACK_SIZE, OsIsrInterruptSource=ENABLE:
      Act_Isr2: OsIsrInterruptNumber=INTNO_ACTISR2_1
      Resource_Isr2: OsIsrInterruptNumber=INTNO_RESOURCE, OsIsrResourceRef=IsrLevelRes
      SetE_Isr2: OsIsrInterruptNumber=INTNO_SET_EVENT_1, OsIsrResourceRef=TskLevelRes, OsIsrResourceRef=IsrLevelRes
      Int_A_Isr2: OsIsrInterruptNumber=INTNO_INT_A_TIMER
      Int_B_Isr2: OsIsrInterruptNumber=INTNO_INT_B_TIMER
      OSAP1_M_Int_MC_Isr2: OsIsrInterruptNumber=INTNO_INT_MC_TIMER
    IOC (OsIoc)
      4 x OsIocCommunication:
        IOC_QUEUE_OSAP1: OsIocBufferLength=1
          IOC_QUEUE_OSAP1_DATA (OsIocDataProperties): OsIocDataPropertyIndex=0, OsIocInitValue=10U, OsIocDataTypeRef=uint8
          IOC_QUEUE_OSAP1_RCV (OsIocReceiverProperties): OsIocFunctionImplementationKind=FUNCTION, OsIocReceivingOsApplicationRef=OSAP2_M
          IOC_QUEUE_OSAP1_SND (OsIocSenderProperties): OsIocFunctionImplementationKind=FUNCTION, OsIocSendingOsApplicationRef=OSAP1_M
        IOC_DEQUEUE_OSAP1
          IOC_DEQUEUE_OSAP1_DATA (OsIocDataProperties): OsIocDataPropertyIndex=0, OsIocInitValue=10U, OsIocDataTypeRef=uint8
          IOC_DEQUEUE_OSAP1_RCV (OsIocReceiverProperties): OsIocFunctionImplementationKind=FUNCTION, OsIocReceivingOsApplicationRef=OSAP2_M
          IOC_DEQUEUE_OSAP1_SND (OsIocSenderProperties): OsIocFunctionImplementationKind=FUNCTION, OsIocSendingOsApplicationRef=OSAP1_M
        IOC_QUEUE_OSAP1_M: OsIocBufferLength=1
          IOC_QUEUE_OSAP1_M_DATA (OsIocDataProperties): OsIocDataPropertyIndex=0, OsIocInitValue=10U, OsIocDataTypeRef=uint8
          IOC_QUEUE_OSAP1_M_RCV (OsIocReceiverProperties): OsIocFunctionImplementationKind=FUNCTION, OsIocReceivingOsApplicationRef=OSAP2_S
          IOC_QUEUE_OSAP1_M_SND (OsIocSenderProperties): OsIocFunctionImplementationKind=FUNCTION, OsIocSendingOsApplicationRef=OSAP1_M
        IOC_DEQUEUE_OSAP1_M
          IOC_DEQUEUE_OSAP1_M_DATA (OsIocDataProperties): OsIocDataPropertyIndex=0, OsIocInitValue=10U, OsIocDataTypeRef=uint8
          IOC_DEQUEUE_OSAP1_M_RCV (OsIocReceiverProperties): OsIocFunctionImplementationKind=FUNCTION, OsIocReceivingOsApplicationRef=OSAP2_S
          IOC_DEQUEUE_OSAP1_M_SND (OsIocSenderProperties): OsIocFunctionImplementationKind=FUNCTION, OsIocSendingOsApplicationRef=OSAP1_M
    35 x OsTask, all with OsTaskActivation=1, OsTaskStackSize=TASK_STACK_SIZE, OsTaskSchedule=FULL:
      MainTask: OsTaskPriority=1
        OsTaskAutostart: OsTaskAppModeRef=MainApp
      Act_Task1: OsTaskPriority=2
      Act_Task2: OsTaskPriority=3
      Act_Task3: OsTaskPriority=4
      Act_Task4: OsTaskPriority=5
      OSAP1_M_Act_Task1: OsTaskPriority=2
      OSAP2_S_Act_Task2: OsTaskPriority=3
      OSAP2_S_Act_Task3: OsTaskPriority=4
      Ter_Task1: OsTaskPriority=2
      Ter_Task2: OsTaskPriority=3
      Chain_Task1: OsTaskPriority=2
      Chain_Task2: OsTaskPriority=3
      Interrupt_Task1: OsTaskPriority=2
      Resource_Task1: OsTaskPriority=2, OsTaskResourceRef=TskLevelRes, OsTaskResourceRef=IsrLevelRes
      Resource_Task2: OsTaskPriority=3, OsTaskResourceRef=TskLevelRes
      Event_Task1: OsTaskPriority=2
      Event_Task2: OsTaskPriority=3, OsTaskEventRef=Event_T2Evt
      SetE_Task1: OsTaskPriority=2
      SetE_Task2: OsTaskPriority=3, OsTaskEventRef=Event_T2SetEvt
      SetE_Task3: OsTaskPriority=4, OsTaskEventRef=Event_T3Evt
      OSAP1_M_SetE_Task1: OsTaskPriority=2
      OSAP2_S_SetE_Task2: OsTaskPriority=3
      OSAP2_S_SetE_Task3: OsTaskPriority=4, OsTaskEventRef=Event_MC_T3Evt
      Int_A_Task1: OsTaskPriority=2
      Int_B_Task1: OsTaskPriority=2
      Int_B_Task2: OsTaskPriority=3
      PrintTask: OsTaskPriority=2
      OSAP1_M_Int_MC_Task1: OsTaskPriority=2
      OSAP2_S_Int_MC_Task2: OsTaskPriority=3
      OSAP1_M_Spin_Task1: OsTaskPriority=2
      OSAP1_IOC_Task1: OsTaskPriority=2
      OSAP2_IOC_Task2: OsTaskPriority=3
      OSAP1_M_IOC_Task1: OsTaskPriority=2
      OSAP2_S_IOC_Task2: OsTaskPriority=3
      S_IdleTask: OsTaskPriority=1
    3 x OsApplication, all with OsTrusted=true:
      OSAP1_M: OsApplicationCoreAssignment=OS_CORE_ID_MASTER, OsAppTaskRef=MainTask, OsAppTaskRef=Act_Task1, OsAppTaskRef=Act_Task2, OsAppTaskRef=Act_Task3, OsAppTaskRef=Act_Task4, OsAppTaskRef=OSAP1_M_Act_Task1, OsAppTaskRef=Ter_Task1, OsAppTaskRef=Ter_Task2, OsAppTaskRef=Chain_Task1, OsAppTaskRef=Chain_Task2, OsAppTaskRef=Interrupt_Task1, OsAppTaskRef=Resource_Task1, OsAppTaskRef=Resource_Task2, OsAppTaskRef=Event_Task1, OsAppTaskRef=Event_Task2, OsAppTaskRef=SetE_Task1, OsAppTaskRef=SetE_Task2, OsAppTaskRef=SetE_Task3, OsAppTaskRef=OSAP1_M_SetE_Task1, OsAppTaskRef=Int_A_Task1, OsAppTaskRef=Int_B_Task1, OsAppTaskRef=Int_B_Task2, OsAppTaskRef=PrintTask, OsAppTaskRef=OSAP1_M_Int_MC_Task1, OsAppTaskRef=OSAP1_M_Spin_Task1, OsAppTaskRef=OSAP1_IOC_Task1, OsAppTaskRef=OSAP1_M_IOC_Task1, OsAppIsrRef=Act_Isr2, OsAppIsrRef=Resource_Isr2, OsAppIsrRef=SetE_Isr2, OsAppIsrRef=Int_A_Isr2, OsAppIsrRef=Int_B_Isr2, OsAppIsrRef=OSAP1_M_Int_MC_Isr2
        OsApplicationHooks: OsAppErrorHook=false, OsAppShutdownHook=false, OsAppStartupHook=false
      OSAP2_M: OsApplicationCoreAssignment=OS_CORE_ID_MASTER, OsAppTaskRef=OSAP2_IOC_Task2
        OsApplicationHooks: OsAppErrorHook=false, OsAppShutdownHook=false, OsAppStartupHook=false
      OSAP2_S: OsApplicationCoreAssignment=OS_CORE_ID_SLAVE, OsAppTaskRef=OSAP2_S_Act_Task2, OsAppTaskRef=OSAP2_S_Act_Task3, OsAppTaskRef=OSAP2_S_SetE_Task2, OsAppTaskRef=OSAP2_S_SetE_Task3, OsAppTaskRef=OSAP2_S_Int_MC_Task2, OsAppTaskRef=OSAP2_S_IOC_Task2, OsAppTaskRef=S_IdleTask
        OsApplicationHooks: OsAppErrorHook=false, OsAppShutdownHook=false, OsAppStartupHook=false
