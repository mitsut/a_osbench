AUTOSAR XML (schema 4-0-3)
package /Ecuc
  module config Os: ecuc-def-edition=4.2.0, implementation-config-variant=VARIANT-PRE-COMPILE
    OsInclude1 (OsInclude): OsIncludeFileName=perf_general.h
    OsInclude2 (OsInclude): OsIncludeFileName=test_target_lib.h
    OsOS: OsStackMonitoring=false, OsUseGetServiceId=true, OsUseParameterAccess=true, OsScalabilityClass=SC1, OsStatus=EXTENDED
      OsHooks: OsErrorHook=true, OsPostTaskHook=false, OsPreTaskHook=false, OsProtectionHook=true, OsShutdownHook=false, OsStartupHook=false
    MainApp (OsAppMode)
    3 x OsEvent:
      Event_T2Evt: OsEventMask=EVENT_T2_MASK
      Event_T2SetEvt: OsEventMask=SETEVENT_T2_MASK
      Event_T3Evt: OsEventMask=EVENT_T3_MASK
    TskLevelRes (OsResource): OsResourceProperty=STANDARD
    IsrLevelRes (OsResource): OsResourceProperty=STANDARD
    5 x OsIsr, all with OsIsrCategory=CATEGORY_2, OsIsrInterruptPriority=INTPRI_TIMER_NUM, OsIsrStackSize=ISR_STACK_SIZE, OsIsrInterruptSource=ENABLE:
      Act_Isr2: OsIsrInterruptNumber=INTNO_ACTISR2_1
      Resource_Isr2: OsIsrInterruptNumber=INTNO_RESOURCE, OsIsrResourceRef=IsrLevelRes
      SetE_Isr2: OsIsrInterruptNumber=INTNO_SET_EVENT_1, OsIsrResourceRef=TskLevelRes, OsIsrResourceRef=IsrLevelRes
      Int_A_Isr2: OsIsrInterruptNumber=INTNO_INT_A_TIMER
      Int_B_Isr2: OsIsrInterruptNumber=INTNO_INT_B_TIMER
    21 x OsTask, all with OsTaskActivation=1, OsTaskStackSize=TASK_STACK_SIZE, OsTaskSchedule=FULL:
      MainTask: OsTaskPriority=1
        OsTaskAutostart: OsTaskAppModeRef=MainApp
      Act_Task1: OsTaskPriority=2
      Act_Task2: OsTaskPriority=3
      Act_Task3: OsTaskPriority=4
      Act_Task4: OsTaskPriority=5
      Ter_Task1: OsTaskPriority=2
      Ter_Task2: OsTaskPriority=3
      Chain_Task1: OsTaskPriority=2
      Chain_Task2: OsTaskPriority=3
      Interrupt_Task1: OsTaskPriority=2
      Resource_Task1: OsTaskPriority=2, OsTaskResourceRef=TskLevelRes, OsTaskResourceRef=IsrLevelRes
      Resource_Task2: OsTaskPriority=3, OsTaskResourceRef=TskLevelRes
      Event_Task1: OsTaskPriority=2
      Event_Task2: OsTaskPriority=3, OsTaskEventRef=Event_T2Evt
      SetE_Task1: OsTaskPriority=2
      SetE_Task2: OsTaskPriority=3, OsTaskEventRef=Event_T2SetEvt
      SetE_Task3: OsTaskPriority=4, OsTaskEventRef=Event_T3Evt
      Int_A_Task1: OsTaskPriority=2
      Int_B_Task1: OsTaskPriority=2
      Int_B_Task2: OsTaskPriority=3
      PrintTask: OsTaskPriority=2
