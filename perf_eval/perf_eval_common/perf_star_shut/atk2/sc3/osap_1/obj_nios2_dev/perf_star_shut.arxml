AUTOSAR XML (schema 4-0-3)
package /Ecuc
  module config Os: ecuc-def-edition=4.2.0, implementation-config-variant=VARIANT-PRE-COMPILE
    OsInclude1 (OsInclude): OsIncludeFileName=perf_star_shut.h
    OsInclude2 (OsInclude): OsIncludeFileName=test_target_lib.h
    OsOS: OsStackMonitoring=false, OsUseGetServiceId=true, OsUseParameterAccess=true, OsScalabilityClass=SC3, OsStatus=EXTENDED
      OsHooks: OsErrorHook=true, OsPostTaskHook=false, OsPreTaskHook=false, OsProtectionHook=true, OsShutdownHook=false, OsStartupHook=false
    MainApp (OsAppMode)
    MainTask (OsTask): OsTaskActivation=1, OsTaskPriority=1, OsTaskStackSize=TASK_STACK_SIZE, OsTaskSchedule=FULL
      OsTaskAutostart: OsTaskAppModeRef=MainApp
    StartShut_Task1 (OsTask): OsTaskActivation=1, OsTaskPriority=2, OsTaskStackSize=TASK_STACK_SIZE, OsTaskSchedule=FULL
    T_OSAP_MAIN (OsApplication): OsTrusted=true, OsAppTaskRef=MainTask
      OsApplicationHooks: OsAppErrorHook=false, OsAppShutdownHook=false, OsAppStartupHook=false
    T_OSAP1 (OsApplication): OsTrusted=true, OsAppTaskRef=StartShut_Task1
      OsApplicationHooks: OsAppErrorHook=false, OsAppShutdownHook=false, OsAppStartupHook=false
