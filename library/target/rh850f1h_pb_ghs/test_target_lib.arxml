AUTOSAR XML (schema 4-0-3)
package /Ecuc
  module config Os: ecuc-def-edition=4.2.0, implementation-config-variant=VARIANT-PRE-COMPILE
    OsMemoryArea_PerfTimer (OsMemoryArea):
      OsMemoryAreaStartAddress = 0xffe30000
      OsMemoryAreaSize = 0x1000
      OsMemoryAreaWriteable = true
      OsMemoryAreaReadable = true
      OsMemoryAreaExecutable = false
      OsMemoryAreaCacheable = false
      OsMemoryAreaDevice = false
